## CMakeLists.txt
```
# SPDX-License-Identifier: Apache-2.0

cmake_minimum_required(VERSION 3.20.0)

find_package(Zephyr REQUIRED HINTS $ENV{ZEPHYR_BASE})
project(ccsds_frames)

target_sources(app PRIVATE
  src/test_ccsds_cltu.c
  src/test_ccsds_profile.c
  src/test_ccsds_sdls_integration.c
  src/test_ccsds_router.c
  src/test_ccsds_tc_frame.c
  src/test_ccsds_tc_segment.c
  src/test_ccsds_tm_frame.c
)
```

## prj.conf
```kconfig
# SPDX-License-Identifier: Apache-2.0

CONFIG_ZTEST=y
CONFIG_CCSDS=y
CONFIG_CCSDS_TM_MAX_SPACE_PACKET_LEN=4096
CONFIG_CCSDS_TM_QUEUE_DEPTH=4096
CONFIG_CCSDS_TM_FECF=y
```

## src/test_ccsds_cltu.c
```c
#include <zephyr/ztest.h>
#include <errno.h>
#include <stddef.h>
#include <string.h>

#include "ccsds/ccsds_cltu.h"

struct cltu_hex_fixture {
    const char *name;
    const char *hex;
    size_t decoded_len;
};

static int hex_nibble(char c)
{
    if (c >= '0' && c <= '9') {
        return c - '0';
    }

    if (c >= 'a' && c <= 'f') {
        return c - 'a' + 10;
    }

    if (c >= 'A' && c <= 'F') {
        return c - 'A' + 10;
    }

    return -EINVAL;
}

static int decode_hex_fixture(const char *hex, uint8_t *buf, size_t buf_cap,
                              size_t *buf_len)
{
    size_t hex_len;

    if (!hex || !buf || !buf_len) {
        return -EINVAL;
    }

    hex_len = strlen(hex);
    if ((hex_len % 2u) != 0u) {
        return -EINVAL;
    }

    if (buf_cap < (hex_len / 2u)) {
        return -ENOSPC;
    }

    for (size_t i = 0u; i < hex_len; i += 2u) {
        int high = hex_nibble(hex[i]);
        int low = hex_nibble(hex[i + 1u]);

        if (high < 0 || low < 0) {
            return -EINVAL;
        }

        buf[i / 2u] = (uint8_t)((high << 4) | low);
    }

    *buf_len = hex_len / 2u;
    return 0;
}

ZTEST(ccsds_cltu, test_start_sequence_accepts_exact_match)
{
    static const uint8_t candidate[] = {0xeb, 0x90};

    zassert_true(ccsds_cltu_is_start_sequence(candidate));
}

ZTEST(ccsds_cltu, test_start_sequence_accepts_one_bit_error)
{
    for (int bit = 0; bit < 16; bit++) {
        uint16_t value = CLTU_START_SEQUENCE ^ (uint16_t)(1u << bit);
        uint8_t candidate[] = {
            (uint8_t)(value >> 8),
            (uint8_t)value,
        };

        zassert_true(ccsds_cltu_is_start_sequence(candidate), "bit %d", bit);
    }
}

ZTEST(ccsds_cltu, test_start_sequence_rejects_two_bit_error)
{
    uint16_t value = CLTU_START_SEQUENCE ^ 0x0003u;
    uint8_t candidate[] = {
        (uint8_t)(value >> 8),
        (uint8_t)value,
    };

    zassert_false(ccsds_cltu_is_start_sequence(candidate));
}

ZTEST(ccsds_cltu, test_decode_rejects_bad_start_sequence)
{
    static const uint8_t cltu[] = {
        0x00, 0x00,
        0x01, 0x23, 0x45, 0x67, 0x89, 0xab, 0xcd, 0x90,
        0xc5, 0xc5, 0xc5, 0xc5, 0xc5, 0xc5, 0xc5, 0x79,
    };
    uint8_t frame[1];
    size_t frame_len = 0;

    zassert_equal(ccsds_cltu_decode_message(cltu, sizeof(cltu), frame,
                                            sizeof(frame), &frame_len),
                  -EINVAL);
}

ZTEST(ccsds_cltu, test_decode_rejects_short_cltu)
{
    static const uint8_t cltu[] = {0xeb, 0x90};
    uint8_t frame[1];
    size_t frame_len = 0;

    zassert_equal(ccsds_cltu_decode_message(cltu, sizeof(cltu), frame,
                                            sizeof(frame), &frame_len),
                  -EINVAL);
}

ZTEST(ccsds_cltu, test_decode_rejects_unaligned_bch_body)
{
    static const uint8_t cltu[] = {
        0xeb, 0x90,
        0x01, 0x23, 0x45, 0x67, 0x89, 0xab, 0xcd, 0x90,
        0x00,
        0xc5, 0xc5, 0xc5, 0xc5, 0xc5, 0xc5, 0xc5, 0x79,
    };
    uint8_t frame[CCSDS_BCH_DATA_SIZE];
    size_t frame_len = 123;

    zassert_equal(ccsds_cltu_decode_message(cltu, sizeof(cltu), frame,
                                            sizeof(frame), &frame_len),
                  -EINVAL);
    zassert_equal(frame_len, 0);
}

ZTEST(ccsds_cltu, test_decode_rejects_bad_tail_end_byte)
{
    static const uint8_t cltu[] = {
        0xeb, 0x90,
        0x01, 0x23, 0x45, 0x67, 0x89, 0xab, 0xcd, 0x90,
        0xc5, 0xc5, 0xc5, 0xc5, 0xc5, 0xc5, 0xc5, 0x78,
    };
    uint8_t frame[CCSDS_BCH_DATA_SIZE];
    size_t frame_len = 123;

    zassert_equal(ccsds_cltu_decode_message(cltu, sizeof(cltu), frame,
                                            sizeof(frame), &frame_len),
                  -EINVAL);
    zassert_equal(frame_len, 0);
}

ZTEST(ccsds_cltu, test_decode_rejects_bad_tail_sequence_byte)
{
    static const uint8_t cltu[] = {
        0xeb, 0x90,
        0x01, 0x23, 0x45, 0x67, 0x89, 0xab, 0xcd, 0x90,
        0xc5, 0xc5, 0xc5, 0x00, 0xc5, 0xc5, 0xc5, 0x79,
    };
    uint8_t frame[CCSDS_BCH_DATA_SIZE];
    size_t frame_len = 123;

    zassert_equal(ccsds_cltu_decode_message(cltu, sizeof(cltu), frame,
                                            sizeof(frame), &frame_len),
                  -EINVAL);
    zassert_equal(frame_len, 0);
}

ZTEST(ccsds_cltu, test_decode_rejects_small_output_buffer)
{
    static const uint8_t cltu[] = {
        0xeb, 0x90,
        0x01, 0x23, 0x45, 0x67, 0x89, 0xab, 0xcd, 0x90,
        0xc5, 0xc5, 0xc5, 0xc5, 0xc5, 0xc5, 0xc5, 0x79,
    };
    uint8_t frame[CCSDS_BCH_DATA_SIZE - 1u];
    size_t frame_len = 123;

    zassert_equal(ccsds_cltu_decode_message(cltu, sizeof(cltu), frame,
                                            sizeof(frame), &frame_len),
                  -ENOSPC);
    zassert_equal(frame_len, 0);
}

ZTEST(ccsds_cltu, test_decode_copies_bch_data_to_tc_frame)
{
    static const uint8_t cltu[] = {
        0xeb, 0x90,
        0x01, 0x23, 0x45, 0x67, 0x89, 0xab, 0xcd, 0x90,
        0xc5, 0xc5, 0xc5, 0xc5, 0xc5, 0xc5, 0xc5, 0x79,
    };
    static const uint8_t expected[] = {
        0x01, 0x23, 0x45, 0x67, 0x89, 0xab, 0xcd,
    };
    uint8_t frame[sizeof(expected)];
    size_t frame_len = 0;

    zassert_equal(ccsds_cltu_decode_message(cltu, sizeof(cltu), frame,
                                            sizeof(frame), &frame_len),
                  0);
    zassert_equal(frame_len, sizeof(expected));
    zassert_mem_equal(frame, expected, sizeof(expected));
}

ZTEST(ccsds_cltu, test_decode_corrects_single_bit_before_copy)
{
    uint8_t cltu[] = {
        0xeb, 0x90,
        0x81, 0x23, 0x45, 0x67, 0x89, 0xab, 0xcd, 0x90,
        0xc5, 0xc5, 0xc5, 0xc5, 0xc5, 0xc5, 0xc5, 0x79,
    };
    static const uint8_t expected[] = {
        0x01, 0x23, 0x45, 0x67, 0x89, 0xab, 0xcd,
    };
    uint8_t frame[sizeof(expected)];
    size_t frame_len = 0;

    zassert_equal(ccsds_cltu_decode_message(cltu, sizeof(cltu), frame,
                                            sizeof(frame), &frame_len),
                  0);
    zassert_equal(frame_len, sizeof(expected));
    zassert_mem_equal(frame, expected, sizeof(expected));
}

ZTEST(ccsds_cltu, test_decode_accepts_recorded_valid_cltus)
{
    static const struct cltu_hex_fixture fixtures[] = {
        {
            .name = "BC unlock control frame",
            .hex = "eb90307b0007000055f07555555555555522c5c5c5c5c5c5c579",
            .decoded_len = 14u,
        },
        {
            .name = "SET VR control frame",
            .hex = "eb90307b00090082002a1fa63455555555a2c5c5c5c5c5c5c579",
            .decoded_len = 14u,
        },
        {
            .name = "short TC",
            .hex = "eb90007b00191fc0186410c006000b100e16020000010319008800bbe915465555d2c5c5c5c5c5c5c579",
            .decoded_len = 28u,
        },
        {
            .name = "long TC",
            .hex = "eb90007b00ff20c0188810c00700f11002b201000075040004da010402040204031004040405040604fc0704080409040a6a040b040c040d049e0e040f04100411b404120413041404be15041604170418fc0419041a041b04a41c041d041e041f6604200421042204de230424042504265804270428042904d42a042b042c042d2e042e042f043004fc310432043304343204350436043704b8380439043a043b4e043c043d043e04463f044004410442d604430444044504da46044704480449be044a044b044c04864d044e044f0450a404510452045304e0540455045604573604580459045a041e5b045c045d045eda045f04600461046a620463046404657e046604670468040269046a046b046c2c046d046e046f0480700471047204731e347279775555557cc5c5c5c5c5c5c579",
            .decoded_len = 259u,
        },
    };
    uint8_t cltu[CONFIG_CCSDS_MAX_CLTU_LEN];
    uint8_t frame[CONFIG_CCSDS_MAX_FRAME_LEN];

    for (size_t i = 0u; i < ARRAY_SIZE(fixtures); i++) {
        size_t cltu_len = 0u;
        size_t frame_len = 0u;

        zassert_ok(decode_hex_fixture(fixtures[i].hex, cltu, sizeof(cltu),
                                      &cltu_len),
                   "%s", fixtures[i].name);
        zassert_ok(ccsds_cltu_decode_message(cltu, cltu_len, frame,
                                             sizeof(frame), &frame_len),
                   "%s", fixtures[i].name);
        zassert_equal(frame_len, fixtures[i].decoded_len, "%s",
                      fixtures[i].name);
    }
}

ZTEST_SUITE(ccsds_cltu, NULL, NULL, NULL, NULL, NULL);
```

## src/test_ccsds_router.c
```c
#include <errno.h>

#include <zephyr/ztest.h>

#include "ccsds/ccsds_router.h"

struct router_capture {
    uint16_t apid;
    uint8_t calls;
};

static int capture_packet(const struct ccsds_space_packet *packet,
                          void *user_data)
{
    struct router_capture *capture = user_data;

    capture->apid = packet->apid;
    capture->calls++;
    return 0;
}

ZTEST(ccsds_router, test_register_dispatch_and_unregister)
{
    struct ccsds_router router;
    struct router_capture capture = {0};
    struct ccsds_space_packet packet = {
        .apid = 0x321u,
    };

    ccsds_router_init(&router);
    zassert_ok(ccsds_router_register_apid(&router, packet.apid,
                                          capture_packet, &capture));
    zassert_ok(ccsds_router_dispatch(&router, &packet));
    zassert_equal(capture.calls, 1u);
    zassert_equal(capture.apid, packet.apid);

    zassert_ok(ccsds_router_unregister_apid(&router, packet.apid));
    zassert_equal(ccsds_router_dispatch(&router, &packet), -ENOENT);
}

ZTEST(ccsds_router, test_dispatch_bytes_decodes_space_packet)
{
    static const uint8_t encoded[] = {
        0x03u, 0x21u, 0xc0u, 0x07u, 0x00u, 0x00u, 0xa5u,
    };
    struct ccsds_router router;
    struct router_capture capture = {0};

    ccsds_router_init(&router);
    zassert_ok(ccsds_router_register_apid(&router, 0x321u,
                                          capture_packet, &capture));
    zassert_ok(ccsds_router_dispatch_bytes(&router, encoded,
                                            sizeof(encoded)));
    zassert_equal(capture.calls, 1u);
    zassert_equal(capture.apid, 0x321u);
}

ZTEST(ccsds_router, test_rejects_invalid_registration)
{
    struct ccsds_router router;

    ccsds_router_init(&router);
    zassert_equal(ccsds_router_register_apid(
                      &router, CCSDS_APID_MAX + 1u, capture_packet, NULL),
                  -EINVAL);
}

ZTEST_SUITE(ccsds_router, NULL, NULL, NULL, NULL, NULL);
```

## src/test_ccsds_tc_frame.c
```c
#include <errno.h>
#include <string.h>

#include <zephyr/sys/util.h>
#include <zephyr/ztest.h>

#include "ccsds/ccsds_tc_frame.h"

#define TEST_TC_HDR_LEN 5u

static void build_tc_frame(uint8_t *buf, size_t len, uint16_t scid,
                           uint8_t vcid, bool bypass, bool control,
                           uint8_t fsn)
{
    uint16_t frame_len_field = (uint16_t)(len - 1u);

    memset(buf, 0, len);
    buf[0] = (uint8_t)((bypass ? BIT(5) : 0u) |
                       (control ? BIT(4) : 0u) |
                       ((scid >> 8) & 0x03u));
    buf[1] = (uint8_t)scid;
    buf[2] = (uint8_t)(((vcid & 0x3fu) << 2) |
                       ((frame_len_field >> 8) & 0x03u));
    buf[3] = (uint8_t)frame_len_field;
    buf[4] = fsn;
}

ZTEST(ccsds_tc_frame, test_decode_rejects_short_frame)
{
    uint8_t frame_bytes[TEST_TC_HDR_LEN - 1u] = {0};
    struct ccsds_tc_frame frame;

    zassert_equal(ccsds_tc_frame_decode(frame_bytes, sizeof(frame_bytes),
                                        &frame),
                  -EINVAL);
}

ZTEST(ccsds_tc_frame, test_decode_rejects_nonzero_version)
{
    uint8_t frame_bytes[TEST_TC_HDR_LEN];
    struct ccsds_tc_frame frame;

    build_tc_frame(frame_bytes, sizeof(frame_bytes),
                   CONFIG_CCSDS_SPACECRAFT_ID, 0u, false, false, 0u);
    frame_bytes[0] |= BIT(6);

    zassert_equal(ccsds_tc_frame_decode(frame_bytes, sizeof(frame_bytes),
                                        &frame),
                  -EINVAL);
}

ZTEST(ccsds_tc_frame, test_decode_rejects_length_mismatch)
{
    uint8_t frame_bytes[TEST_TC_HDR_LEN + 1u];
    struct ccsds_tc_frame frame;

    build_tc_frame(frame_bytes, sizeof(frame_bytes),
                   CONFIG_CCSDS_SPACECRAFT_ID, 0u, false, false, 0u);
    frame_bytes[3]--;

    zassert_equal(ccsds_tc_frame_decode(frame_bytes, sizeof(frame_bytes),
                                        &frame),
                  -EMSGSIZE);
}

ZTEST(ccsds_tc_frame, test_decode_accepts_cltu_fill_after_frame)
{
    uint8_t frame_bytes[TEST_TC_HDR_LEN + 7u];
    struct ccsds_tc_frame frame;

    build_tc_frame(frame_bytes, TEST_TC_HDR_LEN + 3u,
                   CONFIG_CCSDS_SPACECRAFT_ID, 2u, false, false,
                   0x24u);
    frame_bytes[5] = 0x11u;
    frame_bytes[6] = 0x22u;
    frame_bytes[7] = 0x33u;
    memset(&frame_bytes[8], 0x55, 4u);

    zassert_ok(ccsds_tc_frame_decode(frame_bytes, sizeof(frame_bytes),
                                     &frame));
    zassert_equal(frame.virtual_channel_id, 2u);
    zassert_equal(frame.frame_sequence_number, 0x24u);
    zassert_equal(frame.data_len, 3u);
    zassert_mem_equal(frame.data, &frame_bytes[TEST_TC_HDR_LEN],
                      frame.data_len);
}

ZTEST(ccsds_tc_frame, test_decode_rejects_wrong_spacecraft_id)
{
    uint8_t frame_bytes[TEST_TC_HDR_LEN];
    struct ccsds_tc_frame frame;
    uint16_t wrong_scid = (CONFIG_CCSDS_SPACECRAFT_ID + 1u) & 0x03ffu;

    build_tc_frame(frame_bytes, sizeof(frame_bytes), wrong_scid, 0u, false,
                   false, 0u);

    zassert_equal(ccsds_tc_frame_decode(frame_bytes, sizeof(frame_bytes),
                                        &frame),
                  -EACCES);
}

ZTEST(ccsds_tc_frame, test_decode_data_frame_fields)
{
    uint8_t frame_bytes[TEST_TC_HDR_LEN + 3u];
    struct ccsds_tc_frame frame;

    build_tc_frame(frame_bytes, sizeof(frame_bytes),
                   CONFIG_CCSDS_SPACECRAFT_ID, 17u, false, false,
                   0x42u);
    frame_bytes[5] = 0xaau;
    frame_bytes[6] = 0xbbu;
    frame_bytes[7] = 0xccu;

    zassert_ok(ccsds_tc_frame_decode(frame_bytes, sizeof(frame_bytes),
                                     &frame));
    zassert_equal(frame.spacecraft_id, CONFIG_CCSDS_SPACECRAFT_ID);
    zassert_equal(frame.virtual_channel_id, 17u);
    zassert_false(frame.bypass);
    zassert_false(frame.control_command);
    zassert_equal(frame.frame_sequence_number, 0x42u);
    zassert_equal(frame.data_len, 3u);
    zassert_equal(frame.data, &frame_bytes[TEST_TC_HDR_LEN]);
    zassert_mem_equal(frame.data, &frame_bytes[TEST_TC_HDR_LEN],
                      frame.data_len);
}

ZTEST(ccsds_tc_frame, test_decode_control_frame_fields)
{
    uint8_t frame_bytes[TEST_TC_HDR_LEN + 2u];
    struct ccsds_tc_frame frame;

    build_tc_frame(frame_bytes, sizeof(frame_bytes),
                   CONFIG_CCSDS_SPACECRAFT_ID, 63u, true, true, 0x7eu);
    frame_bytes[5] = 0x01u;
    frame_bytes[6] = 0x02u;

    zassert_ok(ccsds_tc_frame_decode(frame_bytes, sizeof(frame_bytes),
                                     &frame));
    zassert_equal(frame.virtual_channel_id, 63u);
    zassert_true(frame.bypass);
    zassert_true(frame.control_command);
    zassert_equal(frame.frame_sequence_number, 0x7eu);
    zassert_equal(frame.data_len, 2u);
    zassert_equal(frame.data, &frame_bytes[TEST_TC_HDR_LEN]);
}

ZTEST_SUITE(ccsds_tc_frame, NULL, NULL, NULL, NULL, NULL);
```

## src/test_ccsds_tc_segment.c
```c
#include <errno.h>
#include <string.h>

#include <zephyr/ztest.h>

#include "ccsds/ccsds_tc_segment.h"

#define TEST_SEG_HDR(boundary, map_id) \
    (uint8_t)((((uint8_t)(boundary) & 0x03u) << 6) | ((map_id) & 0x3fu))
#define TEST_PACKET_HDR_LEN CCSDS_SPACE_PACKET_PRIMARY_HDR_LEN

struct part_capture {
    struct ccsds_tc_segment_part parts[4];
    size_t count;
};

static void build_packet(uint8_t *buf, size_t payload_len, size_t available_len,
                         uint16_t apid, uint8_t seed)
{
    size_t packet_len = TEST_PACKET_HDR_LEN + payload_len;
    uint16_t length_field = (uint16_t)(payload_len - 1u);

    zassert_true(available_len >= TEST_PACKET_HDR_LEN);
    zassert_true(available_len <= packet_len);

    memset(buf, 0, available_len);
    buf[0] = (uint8_t)(0x10u | ((apid >> 8) & 0x07u));
    buf[1] = (uint8_t)apid;
    buf[2] = (uint8_t)(CCSDS_SEQUENCE_UNSEGMENTED << 6);
    buf[4] = (uint8_t)(length_field >> 8);
    buf[5] = (uint8_t)length_field;

    for (size_t i = 0u; i < available_len - TEST_PACKET_HDR_LEN; i++) {
        buf[TEST_PACKET_HDR_LEN + i] = seed + (uint8_t)i;
    }
}

static int capture_part(const struct ccsds_tc_segment_part *part,
                        void *user_data)
{
    struct part_capture *capture = user_data;

    zassert_true(capture->count < ARRAY_SIZE(capture->parts));
    capture->parts[capture->count++] = *part;

    return 0;
}

ZTEST(ccsds_tc_segment, test_decode_extracts_boundary_and_map_id)
{
    uint8_t bytes[] = {
        TEST_SEG_HDR(CCSDS_TC_SEGMENT_LAST, 42u),
        0xaau,
        0xbbu,
    };
    struct ccsds_tc_segment segment;

    zassert_ok(ccsds_tc_segment_decode(bytes, sizeof(bytes), &segment));
    zassert_equal(segment.boundary, CCSDS_TC_SEGMENT_LAST);
    zassert_equal(segment.map_id, 42u);
    zassert_equal(segment.data, &bytes[CCSDS_TC_SEGMENT_HDR_LEN]);
    zassert_equal(segment.data_len, 2u);
}

ZTEST(ccsds_tc_segment, test_walk_reports_aggregated_complete_packets)
{
    uint8_t bytes[1u + 8u + 9u];
    struct ccsds_tc_segment segment;
    struct part_capture capture = {0};

    bytes[0] = TEST_SEG_HDR(CCSDS_TC_SEGMENT_UNSEGMENTED, 7u);
    build_packet(&bytes[1], 2u, 8u, 0x21u, 0x80u);
    build_packet(&bytes[9], 3u, 9u, 0x22u, 0x90u);

    zassert_ok(ccsds_tc_segment_decode(bytes, sizeof(bytes), &segment));
    zassert_ok(ccsds_tc_segment_walk_parts(&segment, capture_part,
                                           &capture));

    zassert_equal(capture.count, 2u);
    zassert_true(capture.parts[0].starts_packet);
    zassert_true(capture.parts[0].ends_packet);
    zassert_equal(capture.parts[0].map_id, 7u);
    zassert_equal(capture.parts[0].data_len, 8u);
    zassert_equal(capture.parts[0].packet_len, 8u);
    zassert_equal(capture.parts[1].data, &bytes[9]);
    zassert_equal(capture.parts[1].data_len, 9u);
}

ZTEST(ccsds_tc_segment, test_walk_reports_first_fragment)
{
    uint8_t bytes[1u + 8u];
    struct ccsds_tc_segment segment;
    struct part_capture capture = {0};

    bytes[0] = TEST_SEG_HDR(CCSDS_TC_SEGMENT_FIRST, 3u);
    build_packet(&bytes[1], 12u, 8u, 0x31u, 0xa0u);

    zassert_ok(ccsds_tc_segment_decode(bytes, sizeof(bytes), &segment));
    zassert_ok(ccsds_tc_segment_walk_parts(&segment, capture_part,
                                           &capture));

    zassert_equal(capture.count, 1u);
    zassert_true(capture.parts[0].starts_packet);
    zassert_false(capture.parts[0].ends_packet);
    zassert_equal(capture.parts[0].data, &bytes[1]);
    zassert_equal(capture.parts[0].data_len, 8u);
    zassert_equal(capture.parts[0].packet_len, 18u);
}

ZTEST(ccsds_tc_segment, test_walk_rejects_first_without_primary_header)
{
    uint8_t bytes[] = {
        TEST_SEG_HDR(CCSDS_TC_SEGMENT_FIRST, 3u),
        0x01u,
        0x02u,
        0x03u,
    };
    struct ccsds_tc_segment segment;
    struct part_capture capture = {0};

    zassert_ok(ccsds_tc_segment_decode(bytes, sizeof(bytes), &segment));
    zassert_equal(ccsds_tc_segment_walk_parts(&segment, capture_part,
                                              &capture),
                  -EINVAL);
    zassert_equal(capture.count, 0u);
}

ZTEST(ccsds_tc_segment, test_walk_rejects_complete_packet_in_first_segment)
{
    uint8_t bytes[1u + 8u];
    struct ccsds_tc_segment segment;
    struct part_capture capture = {0};

    bytes[0] = TEST_SEG_HDR(CCSDS_TC_SEGMENT_FIRST, 3u);
    build_packet(&bytes[1], 2u, 8u, 0x31u, 0xa0u);

    zassert_ok(ccsds_tc_segment_decode(bytes, sizeof(bytes), &segment));
    zassert_equal(ccsds_tc_segment_walk_parts(&segment, capture_part,
                                              &capture),
                  -EINVAL);
    zassert_equal(capture.count, 0u);
}

ZTEST(ccsds_tc_segment, test_walk_reports_continuation_fragment)
{
    uint8_t bytes[] = {
        TEST_SEG_HDR(CCSDS_TC_SEGMENT_CONTINUATION, 12u),
        0x01u,
        0x02u,
        0x03u,
    };
    struct ccsds_tc_segment segment;
    struct part_capture capture = {0};

    zassert_ok(ccsds_tc_segment_decode(bytes, sizeof(bytes), &segment));
    zassert_ok(ccsds_tc_segment_walk_parts(&segment, capture_part,
                                           &capture));

    zassert_equal(capture.count, 1u);
    zassert_false(capture.parts[0].starts_packet);
    zassert_false(capture.parts[0].ends_packet);
    zassert_equal(capture.parts[0].map_id, 12u);
    zassert_equal(capture.parts[0].data_len, 3u);
    zassert_equal(capture.parts[0].packet_len, 0u);
}

ZTEST(ccsds_tc_segment, test_walk_rejects_truncated_unsegmented_packet)
{
    uint8_t bytes[1u + 8u];
    struct ccsds_tc_segment segment;
    struct part_capture capture = {0};

    bytes[0] = TEST_SEG_HDR(CCSDS_TC_SEGMENT_UNSEGMENTED, 0u);
    build_packet(&bytes[1], 12u, 8u, 0x41u, 0xb0u);

    zassert_ok(ccsds_tc_segment_decode(bytes, sizeof(bytes), &segment));
    zassert_equal(ccsds_tc_segment_walk_parts(&segment, capture_part,
                                              &capture),
                  -EINVAL);
    zassert_equal(capture.count, 0u);
}

ZTEST_SUITE(ccsds_tc_segment, NULL, NULL, NULL, NULL, NULL);
```
