## CMakeLists.txt
```
# SPDX-License-Identifier: Apache-2.0

cmake_minimum_required(VERSION 3.20.0)

find_package(Zephyr REQUIRED HINTS $ENV{ZEPHYR_BASE})
project(ccsds_sdls_tests)

target_sources(app PRIVATE
  src/test_sdls_ep.c
  src/test_sdls_sa_management.c
  src/test_sdls_monitoring.c
  src/test_sdls_psa.c
  src/test_sdls_state.c
  src/test_sdls_wire.c
)
```

## prj.conf
```kconfig
# SPDX-License-Identifier: Apache-2.0

CONFIG_ZTEST=y
CONFIG_ZTEST_STACK_SIZE=4096
CONFIG_CCSDS=y
CONFIG_CCSDS_SDLS=y
CONFIG_HEAP_MEM_POOL_SIZE=4096
```

## src/test_sdls_monitoring.c
```c
#include <string.h>

#include <zephyr/sys/byteorder.h>
#include <zephyr/ztest.h>

#include <ccsds/ccsds_sdls.h>

static void init_empty(struct ccsds_sdls_ctx *ctx)
{
    ccsds_sdls_init(ctx, NULL, 0u, NULL, 0u);
}

static int process(struct ccsds_sdls_ctx *ctx, const uint8_t *command,
                   size_t command_len, uint8_t *reply, size_t reply_capacity,
                   size_t *reply_len)
{
    return ccsds_sdls_ep_process_pdu(
        ctx, command, command_len, (struct ccsds_sdls_workspace){0}, reply,
        reply_capacity, reply_len);
}

static int self_test_ok(void *user_data, uint8_t *result)
{
    int *calls = user_data;

    (*calls)++;
    *result = CCSDS_SDLS_SELF_TEST_OK;
    return 0;
}

static int self_test_failed(void *user_data, uint8_t *result)
{
    ARG_UNUSED(user_data);
    *result = CCSDS_SDLS_SELF_TEST_NOT_OK;
    return 0;
}

static int self_test_unsupported(void *user_data, uint8_t *result)
{
    ARG_UNUSED(user_data);
    ARG_UNUSED(result);
    return CCSDS_SDLS_ERR_UNSUPPORTED;
}

static int self_test_invalid(void *user_data, uint8_t *result)
{
    ARG_UNUSED(user_data);
    *result = 1u;
    return 0;
}

ZTEST(sdls_monitoring, test_exact_monitoring_vectors)
{
    struct ccsds_sdls_ctx ctx;
    struct ccsds_sdls_ep_log_status_reply status;
    uint8_t command[CCSDS_SDLS_EP_HEADER_LEN];
    uint8_t reply[CCSDS_SDLS_EP_DUMP_LOG_PDU_MAX];
    size_t reply_len;
    static const uint8_t tags[] = {0x31u, 0x32u, 0x33u, 0x34u, 0x35u};
    uint8_t expected_command[] = {0u, 0u, 0u};
    static const uint8_t alarm[] = {0x37u, 0u, 0u};
    static const uint8_t ping_reply[] = {0xb1u, 0u, 0u};
    static const uint8_t empty_dump[] = {0xb3u, 0u, 0u};
    static const uint8_t empty_status[] = {
        0xb2u, 0u, 0x20u, 0u, 0u, 0u,
        CONFIG_CCSDS_SDLS_EVENT_LOG_CAPACITY};

    init_empty(&ctx);
    for (size_t i = 0u; i < ARRAY_SIZE(tags); i++) {
        ccsds_sdls_ep_monitoring_command_encode(
            (enum ccsds_sdls_ep_monitoring_procedure)(i + 1u), command,
            sizeof(command));
        expected_command[0] = tags[i];
        zassert_mem_equal(command, expected_command, sizeof(expected_command));
    }
    ccsds_sdls_ep_alarm_flag_reset_encode(command, sizeof(command));
    zassert_mem_equal(command, alarm, sizeof(alarm));

    ccsds_sdls_ep_monitoring_command_encode(CCSDS_SDLS_EP_PING, command,
                                             sizeof(command));
    zassert_ok(process(&ctx, command, sizeof(command), reply, sizeof(reply),
                       &reply_len));
    zassert_equal(reply_len, 3u);
    zassert_mem_equal(reply, ping_reply, sizeof(ping_reply));

    ccsds_sdls_ep_monitoring_command_encode(CCSDS_SDLS_EP_LOG_STATUS, command,
                                             sizeof(command));
    zassert_ok(process(&ctx, command, sizeof(command), reply, sizeof(reply),
                       &reply_len));
    zassert_mem_equal(reply, empty_status, sizeof(empty_status));
    zassert_ok(ccsds_sdls_ep_log_status_reply_decode(
        reply, reply_len, CCSDS_SDLS_EP_LOG_STATUS, &status));
    zassert_equal(status.retained_events, 0u);
    zassert_equal(status.remaining_slots,
                  CONFIG_CCSDS_SDLS_EVENT_LOG_CAPACITY);

    ccsds_sdls_ep_monitoring_command_encode(CCSDS_SDLS_EP_ERASE_LOG, command,
                                             sizeof(command));
    zassert_ok(process(&ctx, command, sizeof(command), reply, sizeof(reply),
                       &reply_len));
    zassert_equal(reply[0], 0xb4u);
    zassert_equal(sys_get_be16(reply + 1u), 32u);

    ccsds_sdls_ep_monitoring_command_encode(CCSDS_SDLS_EP_DUMP_LOG, command,
                                             sizeof(command));
    zassert_ok(process(&ctx, command, sizeof(command), reply, sizeof(reply),
                       &reply_len));
    zassert_equal(reply_len, 3u);
    zassert_mem_equal(reply, empty_dump, sizeof(empty_dump));
}

ZTEST(sdls_monitoring, test_ring_wrap_dump_order_and_saturation)
{
    struct ccsds_sdls_ctx ctx;
    uint8_t dump[CCSDS_SDLS_EP_DUMP_LOG_PDU_MAX];
    size_t dump_len;
    size_t insertions = CONFIG_CCSDS_SDLS_EVENT_LOG_CAPACITY * 3u + 2u;

    init_empty(&ctx);
    for (size_t i = 0u; i < insertions; i++) {
        ccsds_sdls_event_record(&ctx, (uint8_t)(0x40u + i),
                                CCSDS_SDLS_EVENT_KEY_STATE,
                                (uint16_t)(0x100u + i), (uint32_t)(0x1000u + i));
    }
    zassert_equal(ctx.event_count, CONFIG_CCSDS_SDLS_EVENT_LOG_CAPACITY);
    zassert_equal(ctx.event_overwrites,
                  insertions - CONFIG_CCSDS_SDLS_EVENT_LOG_CAPACITY);
    zassert_ok(ccsds_sdls_ep_dump_log_reply_encode(&ctx, dump, sizeof(dump),
                                                    &dump_len));
    zassert_equal(dump[0], 0xb3u);
    zassert_equal(sys_get_be16(dump + 1u),
                  CONFIG_CCSDS_SDLS_EVENT_LOG_CAPACITY *
                      CCSDS_SDLS_EVENT_WIRE_LEN * 8u);
    for (size_t i = 0u; i < CONFIG_CCSDS_SDLS_EVENT_LOG_CAPACITY; i++) {
        size_t source = insertions - CONFIG_CCSDS_SDLS_EVENT_LOG_CAPACITY + i;
        size_t offset = CCSDS_SDLS_EP_HEADER_LEN +
                        i * CCSDS_SDLS_EVENT_WIRE_LEN;

        zassert_equal(dump[offset], (uint8_t)(0x40u + source));
        zassert_equal(sys_get_be16(dump + offset + 1u),
                      CCSDS_SDLS_EVENT_VALUE_LEN);
        zassert_equal(dump[offset + 3u], CCSDS_SDLS_EVENT_KEY_STATE);
        zassert_equal(sys_get_be16(dump + offset + 4u),
                      (uint16_t)(0x100u + source));
        zassert_equal(sys_get_be32(dump + offset + 6u),
                      (uint32_t)(0x1000u + source));
    }
    for (size_t i = 0u; i < UINT8_MAX; i++) {
        ccsds_sdls_event_record(&ctx, 1u, CCSDS_SDLS_EVENT_FORMAT, 0u, 0u);
    }
    zassert_equal(ctx.event_overwrites, UINT8_MAX);
}

ZTEST(sdls_monitoring, test_partial_and_full_log_status)
{
    struct ccsds_sdls_ctx ctx;
    struct ccsds_sdls_ep_log_status_reply status;
    uint8_t command[CCSDS_SDLS_EP_HEADER_LEN];
    uint8_t reply[CCSDS_SDLS_EP_HEADER_LEN + 4u];
    size_t reply_len;

    init_empty(&ctx);
    ccsds_sdls_ep_monitoring_command_encode(CCSDS_SDLS_EP_LOG_STATUS, command,
                                             sizeof(command));
    ccsds_sdls_event_record(&ctx, 1u, CCSDS_SDLS_EVENT_FORMAT, 0u, 0u);
    ccsds_sdls_event_record(&ctx, 2u, CCSDS_SDLS_EVENT_KEY_ID, 0u, 0u);
    zassert_ok(process(&ctx, command, sizeof(command), reply, sizeof(reply),
                       &reply_len));
    zassert_ok(ccsds_sdls_ep_log_status_reply_decode(
        reply, reply_len, CCSDS_SDLS_EP_LOG_STATUS, &status));
    zassert_equal(status.retained_events, 2u);
    zassert_equal(status.remaining_slots,
                  CONFIG_CCSDS_SDLS_EVENT_LOG_CAPACITY - 2u);

    while (ctx.event_count < CONFIG_CCSDS_SDLS_EVENT_LOG_CAPACITY) {
        ccsds_sdls_event_record(&ctx, 3u, CCSDS_SDLS_EVENT_SA_STATE, 0u, 0u);
    }
    zassert_ok(process(&ctx, command, sizeof(command), reply, sizeof(reply),
                       &reply_len));
    zassert_ok(ccsds_sdls_ep_log_status_reply_decode(
        reply, reply_len, CCSDS_SDLS_EP_LOG_STATUS, &status));
    zassert_equal(status.retained_events,
                  CONFIG_CCSDS_SDLS_EVENT_LOG_CAPACITY);
    zassert_equal(status.remaining_slots, 0u);
}

ZTEST(sdls_monitoring, test_dump_capacity_and_decoder_outputs_are_atomic)
{
    struct ccsds_sdls_ctx ctx;
    struct ccsds_sdls_ep_log_status_reply decoded = {0xaaaau, 0xbbbbu};
    uint8_t output[CCSDS_SDLS_EVENT_WIRE_LEN + 2u];
    size_t output_len = 99u;
    static const uint8_t bad_status[] = {0xb2u, 0u, 0x18u, 0u, 1u, 0u};

    init_empty(&ctx);
    ccsds_sdls_event_record(&ctx, 0x31u, CCSDS_SDLS_EVENT_FORMAT, 1u, 2u);
    memset(output, 0xa5, sizeof(output));
    zassert_equal(ccsds_sdls_ep_dump_log_reply_encode(
                      &ctx, output, sizeof(output), &output_len),
                  CCSDS_SDLS_ERR_CAPACITY);
    zassert_mem_equal(output,
                      (uint8_t[sizeof(output)]){
                          [0 ... sizeof(output) - 1] = 0xa5},
                      sizeof(output));
    zassert_equal(output_len, 99u);
    zassert_equal(ccsds_sdls_ep_log_status_reply_decode(
                      bad_status, sizeof(bad_status),
                      CCSDS_SDLS_EP_LOG_STATUS, &decoded),
                  CCSDS_SDLS_ERR_FORMAT);
    zassert_equal(decoded.retained_events, 0xaaaau);
    zassert_equal(decoded.remaining_slots, 0xbbbbu);
}

ZTEST(sdls_monitoring, test_erase_is_atomic_and_preserves_unrelated_state)
{
    struct ccsds_sdls_ctx ctx;
    uint8_t command[3];
    uint8_t reply[7];
    uint8_t too_small[6] = {0};
    size_t reply_len = 55u;

    init_empty(&ctx);
    ctx.fsr = (struct ccsds_sdls_fsr){.alarm = true,
                                      .bad_mac = true,
                                      .last_spi = 0x1234u,
                                      .last_arsn_lsb = 0x56u};
    ctx.tx_iv = 0x123456789abcdef0u;
    ctx.fsr_next = true;
    ccsds_sdls_event_record(&ctx, 1u, CCSDS_SDLS_EVENT_FORMAT, 2u, 3u);
    ccsds_sdls_ep_monitoring_command_encode(CCSDS_SDLS_EP_ERASE_LOG, command,
                                             sizeof(command));
    zassert_equal(process(&ctx, command, sizeof(command), too_small,
                          sizeof(too_small), &reply_len),
                  CCSDS_SDLS_ERR_CAPACITY);
    zassert_equal(ctx.event_count, 1u);
    zassert_equal(reply_len, 55u);

    zassert_ok(process(&ctx, command, sizeof(command), reply, sizeof(reply),
                       &reply_len));
    zassert_equal(ctx.event_count, 0u);
    zassert_equal(ctx.event_read_index, 0u);
    zassert_equal(ctx.event_write_index, 0u);
    zassert_equal(ctx.event_overwrites, 0u);
    zassert_mem_equal(ctx.events, (uint8_t[sizeof(ctx.events)]){0},
                      sizeof(ctx.events));
    zassert_true(ctx.fsr.alarm);
    zassert_true(ctx.fsr.bad_mac);
    zassert_equal(ctx.fsr.last_spi, 0x1234u);
    zassert_equal(ctx.tx_iv, 0x123456789abcdef0u);
    zassert_true(ctx.fsr_next);
}

ZTEST(sdls_monitoring, test_alarm_reset_preserves_event_ring)
{
    struct ccsds_sdls_ctx ctx;
    struct ccsds_sdls_event before;
    uint8_t command[CCSDS_SDLS_EP_HEADER_LEN];
    size_t reply_len = 1u;

    init_empty(&ctx);
    ctx.fsr.alarm = true;
    ctx.fsr.bad_sequence = true;
    ctx.fsr.bad_mac = true;
    ctx.fsr.bad_sa = true;
    ctx.fsr.last_spi = 0x1234u;
    ctx.fsr.last_arsn_lsb = 0x56u;
    ccsds_sdls_event_record(&ctx, 0x31u, CCSDS_SDLS_EVENT_FORMAT, 1u, 2u);
    before = ctx.events[0];
    ccsds_sdls_ep_alarm_flag_reset_encode(command, sizeof(command));
    zassert_ok(process(&ctx, command, sizeof(command), NULL, 0u, &reply_len));
    zassert_false(ctx.fsr.alarm);
    zassert_false(ctx.fsr.bad_sequence);
    zassert_false(ctx.fsr.bad_mac);
    zassert_false(ctx.fsr.bad_sa);
    zassert_equal(ctx.fsr.last_spi, 0x1234u);
    zassert_equal(ctx.fsr.last_arsn_lsb, 0x56u);
    zassert_equal(ctx.event_count, 1u);
    zassert_mem_equal(&ctx.events[0], &before, sizeof(before));
    zassert_equal(reply_len, 0u);
}

ZTEST(sdls_monitoring, test_self_test_contract)
{
    struct ccsds_sdls_ctx ctx;
    uint8_t command[3];
    uint8_t reply[4];
    uint8_t result = 0xa5u;
    size_t reply_len = 77u;
    int calls = 0;
    static const uint8_t missing_reply[] = {0xb5u, 0u, 8u, 0x80u};
    static const uint8_t unchanged[] = {0xa5u, 0xa5u, 0xa5u, 0xa5u};

    init_empty(&ctx);
    ccsds_sdls_ep_monitoring_command_encode(CCSDS_SDLS_EP_SELF_TEST, command,
                                             sizeof(command));
    zassert_ok(process(&ctx, command, sizeof(command), reply, sizeof(reply),
                       &reply_len));
    zassert_mem_equal(reply, missing_reply, sizeof(missing_reply));
    zassert_equal(ctx.event_count, 1u);

    ccsds_sdls_set_self_test(&ctx, self_test_ok, &calls);
    zassert_ok(process(&ctx, command, sizeof(command), reply, sizeof(reply),
                       &reply_len));
    zassert_equal(calls, 1);
    zassert_equal(ctx.event_count, 1u);
    zassert_ok(ccsds_sdls_ep_self_test_reply_decode(reply, reply_len, &result));
    zassert_equal(result, CCSDS_SDLS_SELF_TEST_OK);

    ccsds_sdls_set_self_test(&ctx, self_test_failed, NULL);
    zassert_ok(process(&ctx, command, sizeof(command), reply, sizeof(reply),
                       &reply_len));
    zassert_equal(reply[3], CCSDS_SDLS_SELF_TEST_NOT_OK);
    zassert_equal(ctx.event_count, 2u);

    ccsds_sdls_set_self_test(&ctx, self_test_unsupported, NULL);
    zassert_ok(process(&ctx, command, sizeof(command), reply, sizeof(reply),
                       &reply_len));
    zassert_equal(reply[3], CCSDS_SDLS_SELF_TEST_NOT_OK);

    ccsds_sdls_set_self_test(&ctx, self_test_invalid, NULL);
    memset(reply, 0xa5, sizeof(reply));
    reply_len = 77u;
    zassert_equal(process(&ctx, command, sizeof(command), reply, sizeof(reply),
                          &reply_len),
                  CCSDS_SDLS_ERR_FORMAT);
    zassert_mem_equal(reply, unchanged, sizeof(unchanged));
    zassert_equal(reply_len, 77u);
    zassert_equal(result, CCSDS_SDLS_SELF_TEST_OK);
}

ZTEST(sdls_monitoring, test_ep_failure_provenance_and_stale_metadata)
{
    struct ccsds_sdls_ctx ctx;
    uint8_t bad_ping[] = {0x31u, 0u, 8u, 0xaau};
    uint8_t ping[] = {0x31u, 0u, 0u};
    uint8_t reply[3];
    size_t reply_len = 0u;

    init_empty(&ctx);
    ctx.authenticated_rx_valid = true;
    ctx.authenticated_rx_spi = 0x1234u;
    ctx.authenticated_rx_arsn = 0x89abcdefu;
    zassert_equal(process(&ctx, bad_ping, sizeof(bad_ping), reply,
                          sizeof(reply), &reply_len),
                  CCSDS_SDLS_ERR_FORMAT);
    zassert_equal(ctx.event_count, 1u);
    zassert_equal(ctx.events[0].pdu_or_event_tag, 0x31u);
    zassert_equal(ctx.events[0].spi, 0x1234u);
    zassert_equal(ctx.events[0].arsn, 0x89abcdefu);
    zassert_false(ctx.authenticated_rx_valid);
    zassert_equal(ctx.authenticated_rx_spi, 0u);
    zassert_equal(ctx.authenticated_rx_arsn, 0u);

    zassert_ok(process(&ctx, ping, sizeof(ping), reply, sizeof(reply),
                       &reply_len));
    zassert_equal(ctx.event_count, 1u);
}

ZTEST_SUITE(sdls_monitoring, NULL, NULL, NULL, NULL, NULL);
```

## src/test_sdls_psa.c
```c
#include <string.h>

#include <psa/crypto.h>
#include <zephyr/ztest.h>

static void wipe_key(uint8_t *key, size_t len)
{
    volatile uint8_t *p = key;

    while (len-- > 0u) {
        *p++ = 0u;
    }
}

static psa_key_id_t imported_key = PSA_KEY_ID_NULL;

static psa_key_id_t import_test_key(uint8_t plaintext_key[32])
{
    psa_key_attributes_t attributes = PSA_KEY_ATTRIBUTES_INIT;
    psa_key_id_t key_id = PSA_KEY_ID_NULL;
    psa_status_t status;

    psa_set_key_usage_flags(&attributes,
                            PSA_KEY_USAGE_ENCRYPT | PSA_KEY_USAGE_DECRYPT);
    psa_set_key_algorithm(&attributes, PSA_ALG_GCM);
    psa_set_key_type(&attributes, PSA_KEY_TYPE_AES);
    psa_set_key_bits(&attributes, 256u);
    status = psa_import_key(&attributes, plaintext_key, 32u, &key_id);
    wipe_key(plaintext_key, 32u);
    psa_reset_key_attributes(&attributes);

    zassert_mem_equal(plaintext_key, (uint8_t[32]){ 0 },
                      32u);
    zassert_equal(status, PSA_SUCCESS);
    imported_key = key_id;
    return key_id;
}

ZTEST(sdls_psa, test_nist_aes_256_gcm_encrypt_decrypt_and_bad_tag)
{
    /* NIST SP 800-38D AES-256-GCM, zero key/IV, one zero block. */
    uint8_t key_bytes[32] = { 0 };
    static const uint8_t nonce[12] = { 0 };
    static const uint8_t plaintext[16] = { 0 };
    static const uint8_t expected[32] = {
        0xce, 0xa7, 0x40, 0x3d, 0x4d, 0x60, 0x6b, 0x6e,
        0x07, 0x4e, 0xc5, 0xd3, 0xba, 0xf3, 0x9d, 0x18,
        0xd0, 0xd1, 0xc8, 0xa7, 0x99, 0x99, 0x6b, 0xf0,
        0x26, 0x5b, 0x98, 0xb5, 0xd4, 0x8a, 0xb9, 0x19,
    };
    psa_key_id_t key_id = import_test_key(key_bytes);
    uint8_t encrypted[sizeof(expected)];
    uint8_t decrypted[sizeof(plaintext)];
    size_t output_len;

    zassert_equal(psa_aead_encrypt(key_id, PSA_ALG_GCM, nonce, sizeof(nonce),
                                   NULL, 0u, plaintext, sizeof(plaintext),
                                   encrypted, sizeof(encrypted), &output_len),
                  PSA_SUCCESS);
    zassert_equal(output_len, sizeof(expected));
    zassert_mem_equal(encrypted, expected, sizeof(expected));
    zassert_equal(psa_aead_decrypt(key_id, PSA_ALG_GCM, nonce, sizeof(nonce),
                                   NULL, 0u, encrypted, output_len, decrypted,
                                   sizeof(decrypted), &output_len),
                  PSA_SUCCESS);
    zassert_equal(output_len, sizeof(plaintext));
    zassert_mem_equal(decrypted, plaintext, sizeof(plaintext));

    encrypted[sizeof(encrypted) - 1u] ^= 0x01u;
    zassert_equal(psa_aead_decrypt(key_id, PSA_ALG_GCM, nonce, sizeof(nonce),
                                   NULL, 0u, encrypted, sizeof(encrypted),
                                   decrypted, sizeof(decrypted), &output_len),
                  PSA_ERROR_INVALID_SIGNATURE);
}

ZTEST(sdls_psa, test_nist_gmac_style_zero_plaintext_with_aad)
{
    /*
     * NIST GCMVS AES-256 Count 0 (128-bit tag, zero plaintext, 1024-bit AAD).
     * This is GMAC: the entire input is AAD and PSA receives no plaintext.
     */
    uint8_t key_bytes[32] = {
        0x43, 0xc9, 0xe2, 0x09, 0xda, 0x3c, 0x19, 0x71,
        0xd9, 0x86, 0xa4, 0x5b, 0x92, 0xf2, 0xfa, 0x0d,
        0x2d, 0x15, 0x51, 0x83, 0x73, 0x0d, 0x21, 0xd7,
        0x1e, 0xd8, 0xe2, 0x28, 0x4e, 0xc3, 0x08, 0xe3,
    };
    static const uint8_t nonce[16] = {
        0x78, 0xbe, 0xf6, 0x55, 0xdf, 0xd8, 0x99, 0x0b,
        0x04, 0xd2, 0xa2, 0x56, 0x78, 0xd7, 0x08, 0x6d,
    };
    static const uint8_t aad[128] = {
        0x9d, 0x8c, 0x67, 0x34, 0x54, 0x67, 0x97, 0xc5,
        0x81, 0xb9, 0xb1, 0xd0, 0xd4, 0xf0, 0x5b, 0x27,
        0xfe, 0x05, 0x39, 0xbd, 0x01, 0x65, 0x5d, 0x2d,
        0x1a, 0x8a, 0x14, 0x89, 0xcd, 0xf8, 0x04, 0x22,
        0x87, 0x53, 0xd7, 0x72, 0x72, 0xbf, 0x6d, 0xed,
        0x19, 0xd4, 0x7a, 0x6a, 0xbd, 0x62, 0x81, 0xea,
        0x95, 0x91, 0xd4, 0xbc, 0xc1, 0xbe, 0x22, 0x23,
        0x05, 0xfd, 0xf6, 0x89, 0xc5, 0xfa, 0xa4, 0xc1,
        0x13, 0x31, 0xcf, 0xfb, 0xf4, 0x22, 0x15, 0x46,
        0x9b, 0x81, 0xf6, 0x1b, 0x40, 0x41, 0x5d, 0x81,
        0xcc, 0x37, 0x16, 0x1e, 0x5c, 0x02, 0x58, 0xa6,
        0x76, 0x42, 0xb9, 0xb8, 0xac, 0x62, 0x7d, 0x6e,
        0x39, 0xf4, 0x3e, 0x48, 0x5e, 0x1f, 0xf5, 0x22,
        0xac, 0x74, 0x2a, 0x07, 0xde, 0xfa, 0x35, 0x69,
        0xae, 0xb5, 0x99, 0x90, 0xcb, 0x44, 0xc4, 0xf3,
        0xd9, 0x52, 0xf8, 0x11, 0x9f, 0xf1, 0x11, 0x1d,
    };
    static const uint8_t expected_tag[16] = {
        0xf1, 0x5d, 0xdf, 0x93, 0x8b, 0xbf, 0x52, 0xc2,
        0x97, 0x7a, 0xda, 0xba, 0xf4, 0x12, 0x0d, 0xe8,
    };
    psa_key_id_t key_id = import_test_key(key_bytes);
    uint8_t tag[16];
    uint8_t no_plaintext[1];
    size_t output_len;

    zassert_equal(psa_aead_encrypt(key_id, PSA_ALG_GCM, nonce, sizeof(nonce),
                                   aad, sizeof(aad), NULL, 0u, tag,
                                   sizeof(tag), &output_len),
                  PSA_SUCCESS);
    zassert_equal(output_len, sizeof(tag));
    zassert_mem_equal(tag, expected_tag, sizeof(expected_tag));
    zassert_equal(psa_aead_decrypt(key_id, PSA_ALG_GCM, nonce, sizeof(nonce),
                                   aad, sizeof(aad), tag, sizeof(tag),
                                   no_plaintext, sizeof(no_plaintext),
                                   &output_len),
                  PSA_SUCCESS);
    zassert_equal(output_len, 0u);

    tag[0] ^= 0x80u;
    zassert_equal(psa_aead_decrypt(key_id, PSA_ALG_GCM, nonce, sizeof(nonce),
                                   aad, sizeof(aad), tag, sizeof(tag),
                                   no_plaintext, sizeof(no_plaintext),
                                   &output_len),
                  PSA_ERROR_INVALID_SIGNATURE);
}

static void *sdls_psa_setup(void)
{
    zassert_equal(psa_crypto_init(), PSA_SUCCESS);
    return NULL;
}

static void sdls_psa_after(void *fixture)
{
    ARG_UNUSED(fixture);

    if (imported_key != PSA_KEY_ID_NULL) {
        zassert_equal(psa_destroy_key(imported_key), PSA_SUCCESS);
        imported_key = PSA_KEY_ID_NULL;
    }
}

ZTEST_SUITE(sdls_psa, NULL, sdls_psa_setup, NULL, sdls_psa_after, NULL);
```

## src/test_sdls_sa_management.c
```c
#include <string.h>

#include <psa/crypto.h>
#include <zephyr/sys/byteorder.h>
#include <zephyr/ztest.h>

#include <ccsds/ccsds_sdls.h>

static psa_key_id_t sa_management_keys[4];

static void transition_to_expired(struct ccsds_sdls_ctx *ctx, uint16_t spi);

static psa_key_id_t import_key(uint8_t seed)
{
    psa_key_attributes_t attributes = PSA_KEY_ATTRIBUTES_INIT;
    uint8_t material[CCSDS_SDLS_EP_KEY_LEN];
    psa_key_id_t key = PSA_KEY_ID_NULL;

    for (size_t i = 0u; i < sizeof(material); i++) {
        material[i] = seed + (uint8_t)i;
    }
    psa_set_key_usage_flags(&attributes,
                            PSA_KEY_USAGE_ENCRYPT | PSA_KEY_USAGE_DECRYPT);
    psa_set_key_algorithm(&attributes, PSA_ALG_GCM);
    psa_set_key_type(&attributes, PSA_KEY_TYPE_AES);
    psa_set_key_bits(&attributes, CCSDS_SDLS_AES_KEY_BITS);
    zassert_equal(psa_import_key(&attributes, material, sizeof(material), &key),
                  PSA_SUCCESS);
    memset(material, 0, sizeof(material));
    psa_reset_key_attributes(&attributes);
    return key;
}

static void init_sa_management_ctx(struct ccsds_sdls_ctx *ctx)
{
    struct ccsds_sdls_key_init keys[] = {
        {.psa_key_id = sa_management_keys[0],
         .key_id = 4u,
         .state = CCSDS_SDLS_KEY_ACTIVE},
        {.psa_key_id = sa_management_keys[1],
         .key_id = 5u,
         .state = CCSDS_SDLS_KEY_ACTIVE},
        {.psa_key_id = sa_management_keys[2],
         .key_id = 6u,
         .state = CCSDS_SDLS_KEY_ACTIVE},
        {.psa_key_id = sa_management_keys[3],
         .key_id = 7u,
         .state = CCSDS_SDLS_KEY_ACTIVE},
    };
    struct ccsds_sdls_sa_init sas[] = {
        {.spi = 1u,
         .key_id = 4u,
         .role = CCSDS_SDLS_SA_OPERATIONAL_TC_RX,
         .mode = CCSDS_SDLS_MODE_GMAC,
         .state = CCSDS_SDLS_SA_OPERATIONAL,
         .has_key = true,
         .rx_arsn_initialized = true,
         .rx_arsn = 10u},
        {.spi = 2u,
         .key_id = 6u,
         .role = CCSDS_SDLS_SA_OPERATIONAL_TM_TX,
         .mode = CCSDS_SDLS_MODE_GCM,
         .state = CCSDS_SDLS_SA_OPERATIONAL,
         .has_key = true},
        {.spi = 3u,
         .role = CCSDS_SDLS_SA_OPERATIONAL_TC_RX,
         .mode = CCSDS_SDLS_MODE_CLEAR,
         .state = CCSDS_SDLS_SA_STOPPED,
         .has_key = false},
    };

    ccsds_sdls_init(ctx, sas, ARRAY_SIZE(sas), keys, ARRAY_SIZE(keys));
}

ZTEST(sdls_sa_management, test_clear_sa_requires_different_authenticated_sa)
{
    struct ccsds_sdls_ctx ctx;
    struct ccsds_sdls_ep_start_sa start = {.spi = 3u};
    uint8_t wire[CCSDS_SDLS_EP_START_SA_PDU_MAX];
    size_t reply_len = 0u;

    init_sa_management_ctx(&ctx);
    ccsds_sdls_ep_start_sa_encode(&start, wire, sizeof(wire));
    zassert_equal(ccsds_sdls_ep_process_pdu(
                      &ctx, wire, CCSDS_SDLS_EP_HEADER_LEN + 2u,
                      (struct ccsds_sdls_workspace){0}, NULL, 0u, &reply_len),
                  CCSDS_SDLS_ERR_AUTHENTICATION);

    ctx.authenticated_rx_valid = true;
    ctx.authenticated_rx_spi = 3u;
    zassert_equal(ccsds_sdls_ep_process_pdu(
                      &ctx, wire, CCSDS_SDLS_EP_HEADER_LEN + 2u,
                      (struct ccsds_sdls_workspace){0}, NULL, 0u, &reply_len),
                  CCSDS_SDLS_ERR_AUTHENTICATION);

    ctx.authenticated_rx_valid = true;
    ctx.authenticated_rx_spi = 1u;
    zassert_ok(ccsds_sdls_ep_process_pdu(
        &ctx, wire, CCSDS_SDLS_EP_HEADER_LEN + 2u,
        (struct ccsds_sdls_workspace){0}, NULL, 0u, &reply_len));
    zassert_equal(ctx.sas[2].state, CCSDS_SDLS_SA_OPERATIONAL);
}

ZTEST(sdls_sa_management,
      test_preprovisioned_startup_key_can_start_but_not_rekey)
{
    const struct ccsds_sdls_key_init key = {
        .psa_key_id = sa_management_keys[0],
        .key_id = 1u,
        .state = CCSDS_SDLS_KEY_ACTIVE,
    };
    const struct ccsds_sdls_sa_init sa = {
        .spi = 1u,
        .key_id = 1u,
        .role = CCSDS_SDLS_SA_EP_REPLY_TX,
        .mode = CCSDS_SDLS_MODE_GCM,
        .state = CCSDS_SDLS_SA_STOPPED,
        .has_key = true,
    };
    struct ccsds_sdls_ep_start_sa start = {.spi = 1u};
    struct ccsds_sdls_ep_rekey_sa rekey = {
        .spi = 1u,
        .key_id = 1u,
    };
    struct ccsds_sdls_ctx ctx;
    uint8_t wire[CCSDS_SDLS_EP_SA_REKEY_PDU_MAX];

    ccsds_sdls_init(&ctx, &sa, 1u, &key, 1u);
    ccsds_sdls_ep_start_sa_encode(&start, wire, sizeof(wire));
    zassert_ok(ccsds_sdls_ep_process_start_sa(
        &ctx, wire, CCSDS_SDLS_EP_HEADER_LEN + 2u));
    transition_to_expired(&ctx, 1u);
    ccsds_sdls_ep_rekey_sa_encode(&rekey, wire, sizeof(wire));
    zassert_equal(ccsds_sdls_ep_process_rekey_sa(
                      &ctx, wire, CCSDS_SDLS_EP_HEADER_LEN + 4u),
                  CCSDS_SDLS_ERR_KEY);
}

ZTEST(sdls_sa_management, test_exact_sa_management_vectors)
{
    struct ccsds_sdls_ep_start_sa start = {.spi = 2u};
    struct ccsds_sdls_ep_start_sa decoded_start;
    struct ccsds_sdls_ep_sa_command simple = {.spi = 2u};
    struct ccsds_sdls_ep_rekey_sa rekey = {
        .spi = 1u, .key_id = 5u, .rx_arsn = 0x12345678u, .has_rx_arsn = true};
    struct ccsds_sdls_ep_rekey_sa decoded_rekey;
    struct ccsds_sdls_ep_set_arsn set = {.spi = 1u, .arsn = 0x89abcdefu};
    struct ccsds_sdls_ep_set_arsn decoded_set;
    struct ccsds_sdls_ep_set_arsn_window window = {.spi = 1u, .window = 8u};
    struct ccsds_sdls_ep_set_arsn_window decoded_window;
    uint8_t wire[CCSDS_SDLS_EP_START_SA_PDU_MAX];
    static const uint8_t start_zero[] = {0x1bu, 0x00u, 0x10u, 0x00u, 0x02u};
    static const uint8_t stop[] = {0x1eu, 0x00u, 0x10u, 0x00u, 0x02u};
    static const uint8_t expire[] = {0x19u, 0x00u, 0x10u, 0x00u, 0x02u};
    static const uint8_t expected_rekey[] = {0x16u, 0x00u, 0x40u, 0x00u,
                                             0x01u, 0x00u, 0x05u, 0x12u,
                                             0x34u, 0x56u, 0x78u};
    static const uint8_t expected_set[] = {0x1au, 0x00u, 0x30u, 0x00u, 0x01u,
                                           0x89u, 0xabu, 0xcdu, 0xefu};
    static const uint8_t expected_window[] = {0x15u, 0x00u, 0x30u, 0x00u, 0x01u,
                                              0x00u, 0x00u, 0x00u, 0x08u};
    static const uint8_t alarm[] = {0x37u, 0x00u, 0x00u};

    ccsds_sdls_ep_start_sa_encode(&start, wire, sizeof(wire));
    zassert_mem_equal(wire, start_zero, sizeof(start_zero));
    zassert_ok(ccsds_sdls_ep_start_sa_decode(wire, sizeof(start_zero),
                                             &decoded_start));
    zassert_equal(decoded_start.spi, 2u);
    zassert_equal(decoded_start.association_count, 0u);

    ccsds_sdls_ep_sa_command_encode(CCSDS_SDLS_EP_STOP_SA, &simple, wire,
                                    sizeof(wire));
    zassert_mem_equal(wire, stop, sizeof(stop));
    ccsds_sdls_ep_sa_command_encode(CCSDS_SDLS_EP_EXPIRE_SA, &simple, wire,
                                    sizeof(wire));
    zassert_mem_equal(wire, expire, sizeof(expire));

    ccsds_sdls_ep_rekey_sa_encode(&rekey, wire, sizeof(wire));
    zassert_mem_equal(wire, expected_rekey, sizeof(expected_rekey));
    zassert_ok(ccsds_sdls_ep_rekey_sa_decode(wire, sizeof(expected_rekey),
                                             &decoded_rekey));
    zassert_equal(decoded_rekey.rx_arsn, rekey.rx_arsn);

    ccsds_sdls_ep_set_arsn_encode(&set, wire, sizeof(wire));
    zassert_mem_equal(wire, expected_set, sizeof(expected_set));
    zassert_ok(ccsds_sdls_ep_set_arsn_decode(wire, sizeof(expected_set),
                                             &decoded_set));
    zassert_equal(decoded_set.arsn, set.arsn);

    ccsds_sdls_ep_set_arsn_window_encode(&window, wire, sizeof(wire));
    zassert_mem_equal(wire, expected_window, sizeof(expected_window));
    zassert_ok(ccsds_sdls_ep_set_arsn_window_decode(
        wire, sizeof(expected_window), &decoded_window));
    zassert_equal(decoded_window.window, window.window);

    ccsds_sdls_ep_alarm_flag_reset_encode(wire, sizeof(wire));
    zassert_mem_equal(wire, alarm, sizeof(alarm));
}

ZTEST(sdls_sa_management, test_malformed_lengths_nested_unknown_and_trailing)
{
    struct ccsds_sdls_ep_start_sa start;
    struct ccsds_sdls_ep_pdu pdu;
    uint8_t incomplete_assoc[] = {0x1bu, 0x00u, 0x18u, 0x00u, 0x01u, 0xaau};
    uint8_t non_octet[] = {0x1bu, 0x00u, 0x11u, 0x00u, 0x01u};
    uint8_t trailing[] = {0x1bu, 0x00u, 0x10u, 0x00u, 0x01u, 0u};
    uint8_t create[] = {0x11u, 0x00u, 0x10u, 0x00u, 0x01u};
    uint8_t nested[] = {0x1bu, 0x00u, 0x18u, 0x1bu, 0x00u, 0u};

    zassert_equal(ccsds_sdls_ep_start_sa_decode(
                      incomplete_assoc, sizeof(incomplete_assoc), &start),
                  CCSDS_SDLS_ERR_FORMAT);
    zassert_equal(ccsds_sdls_ep_pdu_decode(non_octet, sizeof(non_octet), &pdu),
                  CCSDS_SDLS_ERR_FORMAT);
    zassert_equal(
        ccsds_sdls_ep_start_sa_decode(trailing, sizeof(trailing), &start),
        CCSDS_SDLS_ERR_FORMAT);
    zassert_equal(ccsds_sdls_ep_pdu_decode(create, sizeof(create), &pdu),
                  CCSDS_SDLS_ERR_UNSUPPORTED);
    zassert_equal(ccsds_sdls_ep_start_sa_decode(nested, sizeof(nested), &start),
                  CCSDS_SDLS_ERR_FORMAT);
}

static void transition_to_expired(struct ccsds_sdls_ctx *ctx, uint16_t spi)
{
    struct ccsds_sdls_ep_sa_command command = {.spi = spi};
    uint8_t wire[CCSDS_SDLS_EP_HEADER_LEN + 2u];

    ccsds_sdls_ep_sa_command_encode(CCSDS_SDLS_EP_STOP_SA, &command, wire,
                                    sizeof(wire));
    zassert_ok(ccsds_sdls_ep_process_stop_sa(ctx, wire, sizeof(wire)));
    ccsds_sdls_ep_sa_command_encode(CCSDS_SDLS_EP_EXPIRE_SA, &command, wire,
                                    sizeof(wire));
    zassert_ok(ccsds_sdls_ep_process_expire_sa(ctx, wire, sizeof(wire)));
}

ZTEST(sdls_sa_management, test_rekey_tc_and_tm_without_reboot)
{
    struct ccsds_sdls_ctx ctx;
    struct ccsds_sdls_ep_rekey_sa rekey_rx = {
        .spi = 1u, .key_id = 5u, .rx_arsn = 100u, .has_rx_arsn = true};
    struct ccsds_sdls_ep_rekey_sa rekey_tx = {
        .spi = 2u, .key_id = 7u, .has_rx_arsn = false};
    struct ccsds_sdls_ep_start_sa start;
    uint8_t wire[CCSDS_SDLS_EP_SA_REKEY_PDU_MAX];

    init_sa_management_ctx(&ctx);
    ctx.keys[7].tx_arsn = 77u;
    transition_to_expired(&ctx, 1u);
    transition_to_expired(&ctx, 2u);

    ccsds_sdls_ep_rekey_sa_encode(&rekey_rx, wire, sizeof(wire));
    zassert_ok(ccsds_sdls_ep_process_rekey_sa(&ctx, wire, 11u));
    zassert_equal(ctx.sas[0].key_slot, 5u);
    zassert_equal(ctx.sas[0].rx_arsn, 100u);
    zassert_true(ctx.sas[0].rx_arsn_initialized);

    ccsds_sdls_ep_rekey_sa_encode(&rekey_tx, wire, sizeof(wire));
    zassert_ok(ccsds_sdls_ep_process_rekey_sa(&ctx, wire, 7u));
    zassert_equal(ctx.sas[1].key_slot, 7u);
    zassert_equal(ctx.keys[7].tx_arsn, 77u);

    start = (struct ccsds_sdls_ep_start_sa){.spi = 1u};
    ccsds_sdls_ep_start_sa_encode(&start, wire, sizeof(wire));
    zassert_ok(ccsds_sdls_ep_process_start_sa(&ctx, wire, 5u));
    start.spi = 2u;
    ccsds_sdls_ep_start_sa_encode(&start, wire, sizeof(wire));
    zassert_ok(ccsds_sdls_ep_process_start_sa(&ctx, wire, 5u));
    zassert_equal(ctx.sas[0].state, CCSDS_SDLS_SA_OPERATIONAL);
    zassert_equal(ctx.sas[1].state, CCSDS_SDLS_SA_OPERATIONAL);
}

ZTEST(sdls_sa_management,
      test_failed_rekey_is_atomic_and_create_delete_unsupported)
{
    struct ccsds_sdls_ctx ctx;
    struct ccsds_sdls_ctx before;
    struct ccsds_sdls_ep_rekey_sa rekey = {
        .spi = 1u, .key_id = 6u, .rx_arsn = 100u, .has_rx_arsn = true};
    uint8_t wire[CCSDS_SDLS_EP_SA_REKEY_PDU_MAX];
    uint8_t create[] = {0x11u, 0x00u, 0x10u, 0x00u, 0x03u};
    uint8_t delete_sa[] = {0x14u, 0x00u, 0x10u, 0x00u, 0x01u};

    init_sa_management_ctx(&ctx);
    transition_to_expired(&ctx, 1u);
    memcpy(&before, &ctx, sizeof(ctx));
    ccsds_sdls_ep_rekey_sa_encode(&rekey, wire, sizeof(wire));
    zassert_equal(ccsds_sdls_ep_process_rekey_sa(&ctx, wire, 11u),
                  CCSDS_SDLS_ERR_KEY);
    zassert_mem_equal(&ctx, &before, sizeof(ctx));
    zassert_equal(ccsds_sdls_ep_process_start_sa(&ctx, create, sizeof(create)),
                  CCSDS_SDLS_ERR_UNSUPPORTED);
    zassert_equal(
        ccsds_sdls_ep_process_expire_sa(&ctx, delete_sa, sizeof(delete_sa)),
        CCSDS_SDLS_ERR_UNSUPPORTED);
    zassert_mem_equal(&ctx, &before, sizeof(ctx));
}

ZTEST(sdls_sa_management, test_arsn_window_read_status_and_alarm_reset)
{
    struct ccsds_sdls_ctx ctx;
    struct ccsds_sdls_ep_set_arsn set = {.spi = 1u, .arsn = 42u};
    struct ccsds_sdls_ep_set_arsn_window window = {.spi = 1u, .window = 3u};
    struct ccsds_sdls_ep_sa_command query = {.spi = 1u};
    struct ccsds_sdls_ep_read_arsn_reply arsn_reply;
    struct ccsds_sdls_ep_sa_status_reply status_reply;
    size_t reply_len = 99u;
    uint8_t wire[16];
    uint8_t reply[CCSDS_SDLS_EP_SA_REPLY_PDU_MAX];

    init_sa_management_ctx(&ctx);
    ccsds_sdls_ep_set_arsn_encode(&set, wire, sizeof(wire));
    zassert_ok(ccsds_sdls_ep_process_set_arsn(&ctx, wire, 9u));
    ccsds_sdls_ep_set_arsn_window_encode(&window, wire, sizeof(wire));
    zassert_ok(ccsds_sdls_ep_process_set_arsn_window(&ctx, wire, 9u));
    zassert_equal(ctx.sas[0].rx_window, 3u);

    ccsds_sdls_ep_sa_command_encode(CCSDS_SDLS_EP_READ_ARSN, &query, wire,
                                    sizeof(wire));
    zassert_ok(ccsds_sdls_ep_process_read_arsn(&ctx, wire, 5u, reply,
                                               sizeof(reply), &reply_len));
    zassert_equal(reply_len, 9u);
    zassert_ok(
        ccsds_sdls_ep_read_arsn_reply_decode(reply, reply_len, &arsn_reply));
    zassert_equal(arsn_reply.arsn, 42u);

    ccsds_sdls_ep_sa_command_encode(CCSDS_SDLS_EP_SA_STATUS, &query, wire,
                                    sizeof(wire));
    zassert_ok(ccsds_sdls_ep_process_sa_status(&ctx, wire, 5u, reply,
                                               sizeof(reply), &reply_len));
    zassert_ok(
        ccsds_sdls_ep_sa_status_reply_decode(reply, reply_len, &status_reply));
    zassert_equal(status_reply.last_procedure, 0x15u);

    ctx.fsr = (struct ccsds_sdls_fsr){.alarm = true,
                                      .bad_sequence = true,
                                      .bad_mac = true,
                                      .bad_sa = true,
                                      .last_spi = 0x1234u,
                                      .last_arsn_lsb = 0x56u};
    ccsds_sdls_ep_alarm_flag_reset_encode(wire, sizeof(wire));
    zassert_ok(ccsds_sdls_ep_process_alarm_flag_reset(&ctx, wire, 3u));
    zassert_false(ctx.fsr.alarm);
    zassert_false(ctx.fsr.bad_sequence);
    zassert_false(ctx.fsr.bad_mac);
    zassert_false(ctx.fsr.bad_sa);
    zassert_equal(ctx.fsr.last_spi, 0x1234u);
    zassert_equal(ctx.fsr.last_arsn_lsb, 0x56u);
    zassert_equal(ctx.sas[0].rx_arsn, 42u);
    zassert_equal(ctx.sas[0].rx_window, 3u);
}

ZTEST(sdls_sa_management, test_fsr_exact_encoding)
{
    struct ccsds_sdls_ctx ctx;
    uint8_t fsr[CCSDS_SDLS_FSR_LEN];
    static const uint8_t expected[] = {0x4fu, 0x12u, 0x34u, 0x78u};

    init_sa_management_ctx(&ctx);
    ctx.fsr.alarm = true;
    ctx.fsr.bad_sequence = true;
    ctx.fsr.bad_mac = true;
    ctx.fsr.bad_sa = true;
    ctx.fsr.last_spi = 0x1234u;
    ctx.fsr.last_arsn_lsb = 0x78u;
    ccsds_sdls_fsr_encode(&ctx, fsr);
    zassert_mem_equal(fsr, expected, sizeof(expected));
    zassert_false(ctx.fsr_enabled);
    zassert_false(ctx.fsr_next);
    ccsds_sdls_fsr_set_enabled(&ctx, true);
    zassert_true(ctx.fsr_enabled);
}

ZTEST(sdls_sa_management, test_packet_pdu_does_not_manage_frame_fsr)
{
    struct ccsds_sdls_ctx ctx;
    struct ccsds_sdls_ep_set_arsn set = {.spi = 1u, .arsn = 42u};
    struct ccsds_sdls_workspace unused_workspace = {0};
    size_t reply_len = 77u;
    uint8_t wire[CCSDS_SDLS_EP_HEADER_LEN + 6u];

    init_sa_management_ctx(&ctx);
    ctx.fsr.last_spi = 2u;
    ctx.fsr.last_arsn_lsb = 0x78u;
    ctx.authenticated_rx_spi = 2u;
    ctx.authenticated_rx_valid = true;
    ccsds_sdls_ep_set_arsn_encode(&set, wire, sizeof(wire));
    zassert_ok(ccsds_sdls_ep_process_pdu(&ctx, wire, sizeof(wire),
                                         unused_workspace, NULL, 0u,
                                         &reply_len));
    zassert_equal(ctx.sas[0].rx_arsn, 42u);
    zassert_equal(ctx.fsr.last_spi, 2u);
    zassert_equal(ctx.fsr.last_arsn_lsb, 0x78u);
    zassert_equal(reply_len, 0u);

    set.arsn = 41u;
    ccsds_sdls_ep_set_arsn_encode(&set, wire, sizeof(wire));
    reply_len = 77u;
    zassert_equal(ccsds_sdls_ep_process_pdu(
                      &ctx, wire, sizeof(wire), unused_workspace, NULL, 0u,
                      &reply_len),
                  CCSDS_SDLS_ERR_REPLAY);
    zassert_equal(ctx.sas[0].rx_arsn, 42u);
    zassert_equal(ctx.fsr.last_arsn_lsb, 0x78u);
    zassert_equal(reply_len, 77u);

    set.arsn = 43u;
    ccsds_sdls_ep_set_arsn_encode(&set, wire, sizeof(wire));
    ctx.authenticated_rx_spi = 1u;
    ctx.authenticated_rx_arsn = 99u;
    ctx.authenticated_rx_valid = true;
    zassert_ok(ccsds_sdls_ep_process_pdu(&ctx, wire, sizeof(wire),
                                         unused_workspace, NULL, 0u,
                                         &reply_len));
    zassert_equal(ctx.sas[0].rx_arsn, 43u);
    zassert_equal(ctx.fsr.last_arsn_lsb, 0x78u);
    zassert_false(ctx.authenticated_rx_valid);
}

static void *sa_management_setup(void)
{
    zassert_equal(psa_crypto_init(), PSA_SUCCESS);
    return NULL;
}

static void sa_management_before(void *fixture)
{
    ARG_UNUSED(fixture);
    for (size_t i = 0u; i < ARRAY_SIZE(sa_management_keys); i++) {
        sa_management_keys[i] = import_key((uint8_t)(0x20u * (i + 1u)));
    }
}

static void sa_management_after(void *fixture)
{
    ARG_UNUSED(fixture);
    for (size_t i = 0u; i < ARRAY_SIZE(sa_management_keys); i++) {
        zassert_equal(psa_destroy_key(sa_management_keys[i]), PSA_SUCCESS);
        sa_management_keys[i] = PSA_KEY_ID_NULL;
    }
}

ZTEST_SUITE(sdls_sa_management, NULL, sa_management_setup,
            sa_management_before, sa_management_after, NULL);
```

## src/test_sdls_state.c
```c
#include <errno.h>
#include <stddef.h>

#include <zephyr/sys/util.h>
#include <zephyr/ztest.h>

#include <ccsds/ccsds_sdls.h>

BUILD_ASSERT(CONFIG_CCSDS_SDLS_MAX_SA == 4,
             "footprint proof uses four SA slots");
BUILD_ASSERT(CONFIG_CCSDS_SDLS_MAX_KEYS == 8,
             "footprint proof uses eight key slots");
BUILD_ASSERT(CONFIG_CCSDS_SDLS_SESSION_KEY_BASE == 4,
             "lookup proof uses four pre-session key slots");
BUILD_ASSERT(sizeof(struct ccsds_sdls_sa) == 16,
             "SDLS SA state footprint changed");
BUILD_ASSERT(sizeof(struct ccsds_sdls_key) == 12,
             "SDLS key state footprint changed");
BUILD_ASSERT(CCSDS_SDLS_CONTEXT_STATIC_BYTES ==
                 192u + CONFIG_CCSDS_SDLS_EVENT_LOG_CAPACITY * 8u + 16u,
             "default SDLS context footprint changed");
BUILD_ASSERT(offsetof(struct ccsds_sdls_ctx, keys) ==
                 sizeof(((struct ccsds_sdls_ctx *)0)->sas),
             "SDLS key slots must follow SA state");

static const struct ccsds_sdls_key_init valid_keys[] = {
    {
        .psa_key_id = 101u,
        .key_id = 4u,
        .state = CCSDS_SDLS_KEY_ACTIVE,
    },
    {
        .psa_key_id = 102u,
        .key_id = 5u,
        .state = CCSDS_SDLS_KEY_PREACTIVE,
    },
};

static const struct ccsds_sdls_sa_init valid_sas[] = {
    {
        .spi = 1u,
        .key_id = 4u,
        .role = CCSDS_SDLS_SA_EP_COMMAND_RX,
        .mode = CCSDS_SDLS_MODE_GMAC,
        .state = CCSDS_SDLS_SA_OPERATIONAL,
        .has_key = true,
        .rx_arsn_initialized = true,
        .rx_arsn = 42u,
    },
    {
        .spi = 2u,
        .role = CCSDS_SDLS_SA_OPERATIONAL_TM_TX,
        .mode = CCSDS_SDLS_MODE_GCM,
        .state = CCSDS_SDLS_SA_STOPPED,
        .has_key = false,
    },
};

ZTEST(sdls_state, test_context_initialization_and_lookup)
{
    struct ccsds_sdls_ctx ctx;
    struct ccsds_sdls_sa *sa;
    struct ccsds_sdls_key *key;

    ccsds_sdls_init(&ctx, valid_sas, ARRAY_SIZE(valid_sas), valid_keys,
                    ARRAY_SIZE(valid_keys));
    zassert_ok(ccsds_sdls_sa_lookup(&ctx, 1u, &sa));
    zassert_equal(sa->state, CCSDS_SDLS_SA_OPERATIONAL);
    zassert_equal(sa->key_slot, 4u);
    zassert_true(sa->rx_arsn_initialized);
    zassert_equal(sa->rx_arsn, 42u);
    zassert_equal(sa->rx_window, CONFIG_CCSDS_SDLS_ARSN_WINDOW);
    zassert_ok(ccsds_sdls_sa_lookup(&ctx, 2u, &sa));
    zassert_equal(sa->key_slot, CCSDS_SDLS_KEY_SLOT_NONE);
    zassert_ok(ccsds_sdls_key_lookup(&ctx, 5u, &key));
    zassert_equal(key->psa_key_id, 102u);
    zassert_equal(key->tx_arsn, 0u);
    zassert_equal(ctx.tx_iv, CCSDS_SDLS_IV_SEED);
    zassert_false(ctx.fsr_enabled);
    zassert_false(ctx.fsr_next);
}

ZTEST(sdls_state, test_unknown_identifiers)
{
    struct ccsds_sdls_ctx ctx;
    struct ccsds_sdls_sa *sa = (void *)1;
    struct ccsds_sdls_key *key = (void *)1;

    ccsds_sdls_init(&ctx, valid_sas, ARRAY_SIZE(valid_sas), valid_keys,
                    ARRAY_SIZE(valid_keys));
    zassert_equal(ccsds_sdls_sa_lookup(&ctx, 0u, &sa), -ENOENT);
    zassert_is_null(sa);
    zassert_equal(ccsds_sdls_sa_lookup(&ctx, 0xffffu, &sa), -ENOENT);
    zassert_is_null(sa);
    zassert_equal(ccsds_sdls_key_lookup(
                      &ctx, CONFIG_CCSDS_SDLS_MAX_KEYS, &key),
                  -ENOENT);
    zassert_is_null(key);
    zassert_equal(ccsds_sdls_key_lookup(&ctx, 0xffffu, &key), -ENOENT);
    zassert_is_null(key);
}

ZTEST_SUITE(sdls_state, NULL, NULL, NULL, NULL, NULL);
```
