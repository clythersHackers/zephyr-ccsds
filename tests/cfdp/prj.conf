## CMakeLists.txt
```
# SPDX-License-Identifier: Apache-2.0

cmake_minimum_required(VERSION 3.20.0)

# Load only the CCSDS module so this test remains consumer-independent.
set(ZEPHYR_MODULES "${CMAKE_CURRENT_LIST_DIR}/../..")

find_package(Zephyr REQUIRED HINTS $ENV{ZEPHYR_BASE})
project(ccsds_cfdp)

target_sources(app PRIVATE
  src/test_ccsds_cfdp_checksum.c
  src/test_ccsds_cfdp_entity.c
  src/test_ccsds_cfdp_filestore.c
  src/test_ccsds_cfdp_pdu.c
  src/test_ccsds_cfdp_ranges.c
  src/test_ccsds_cfdp_service.c
  src/test_ccsds_cfdp_space_packet.c
  src/test_ccsds_cfdp_types.c
  src/test_ccsds_cfdp_ut.c
)
```

## prj.conf
```kconfig
# SPDX-License-Identifier: Apache-2.0

CONFIG_ZTEST=y
CONFIG_CCSDS=y
CONFIG_CCSDS_CFDP=y
```

## src/test_ccsds_cfdp_checksum.c
```c
#include <zephyr/ztest.h>

#include <string.h>

#include "ccsds/ccsds_cfdp_checksum.h"

#define CCSDS_CFDP_STANDARD_VECTOR_CHECKSUM 0x181c2015u

struct memory_reader_context {
    const uint8_t *data;
    size_t len;
};

static enum ccsds_cfdp_status memory_read(void *user_data, uint32_t offset,
                                          uint8_t *buf, size_t cap,
                                          size_t *len)
{
    struct memory_reader_context *ctx =
        (struct memory_reader_context *)user_data;
    size_t remaining;
    size_t read_len;

    zassert_not_null(ctx);
    zassert_not_null(buf);
    zassert_not_null(len);

    if ((size_t)offset >= ctx->len || cap == 0u) {
        return CCSDS_CFDP_STATUS_INVALID_ARGUMENT;
    }

    remaining = ctx->len - (size_t)offset;
    read_len = remaining < cap ? remaining : cap;
    memcpy(buf, &ctx->data[offset], read_len);
    *len = read_len;

    return CCSDS_CFDP_STATUS_OK;
}

static uint32_t checksum_one_shot(const uint8_t *data, size_t len)
{
    ccsds_cfdp_checksum_state_t state;
    uint32_t checksum;

    zassert_equal(ccsds_cfdp_checksum_init(
                      &state, CCSDS_CFDP_CHECKSUM_TYPE_MODULAR),
                  CCSDS_CFDP_STATUS_OK);
    zassert_equal(ccsds_cfdp_checksum_update(&state, 0u, data, len),
                  CCSDS_CFDP_STATUS_OK);
    zassert_equal(ccsds_cfdp_checksum_finish(&state, &checksum),
                  CCSDS_CFDP_STATUS_OK);

    return checksum;
}

static uint32_t checksum_one_shot_type(enum ccsds_cfdp_checksum_type type,
                                       const uint8_t *data, size_t len)
{
    ccsds_cfdp_checksum_state_t state;
    uint32_t checksum;

    zassert_equal(ccsds_cfdp_checksum_init(&state, type),
                  CCSDS_CFDP_STATUS_OK);
    zassert_equal(ccsds_cfdp_checksum_update(&state, 0u, data, len),
                  CCSDS_CFDP_STATUS_OK);
    zassert_equal(ccsds_cfdp_checksum_finish(&state, &checksum),
                  CCSDS_CFDP_STATUS_OK);

    return checksum;
}

ZTEST(ccsds_cfdp_checksum, test_empty_modular_checksum_is_zero)
{
    ccsds_cfdp_checksum_state_t state;
    uint32_t checksum = 0xffffffffu;

    zassert_equal(ccsds_cfdp_checksum_init(
                      &state, CCSDS_CFDP_CHECKSUM_TYPE_MODULAR),
                  CCSDS_CFDP_STATUS_OK);
    zassert_equal(ccsds_cfdp_checksum_update(&state, 0u, NULL, 0u),
                  CCSDS_CFDP_STATUS_OK);
    zassert_equal(ccsds_cfdp_checksum_finish(&state, &checksum),
                  CCSDS_CFDP_STATUS_OK);
    zassert_equal(checksum, 0u);
}

ZTEST(ccsds_cfdp_checksum, test_standard_annex_f_vector)
{
    static const uint8_t data[] = {
        0x00u, 0x01u, 0x02u, 0x03u, 0x04u, 0x05u, 0x06u, 0x07u,
        0x08u, 0x09u, 0x0au, 0x0bu, 0x0cu, 0x0du, 0x0eu,
    };

    zassert_equal(checksum_one_shot(data, sizeof(data)),
                  CCSDS_CFDP_STANDARD_VECTOR_CHECKSUM);
}

ZTEST(ccsds_cfdp_checksum, test_single_buffer_checksum)
{
    static const uint8_t data[] = {
        0x12u, 0x34u, 0x56u, 0x78u, 0x9au, 0xbcu, 0xdeu, 0xf0u,
    };

    zassert_equal(checksum_one_shot(data, sizeof(data)), 0xacf13568u);
}

ZTEST(ccsds_cfdp_checksum, test_incremental_checksum_equals_one_shot)
{
    static const uint8_t data[] = {
        0x00u, 0x01u, 0x02u, 0x03u, 0x04u, 0x05u, 0x06u, 0x07u,
        0x08u, 0x09u, 0x0au, 0x0bu, 0x0cu, 0x0du, 0x0eu,
    };
    ccsds_cfdp_checksum_state_t state;
    uint32_t checksum;

    zassert_equal(ccsds_cfdp_checksum_init(
                      &state, CCSDS_CFDP_CHECKSUM_TYPE_MODULAR),
                  CCSDS_CFDP_STATUS_OK);
    zassert_equal(ccsds_cfdp_checksum_update(&state, 0u, data, 6u),
                  CCSDS_CFDP_STATUS_OK);
    zassert_equal(ccsds_cfdp_checksum_update(&state, 6u, &data[6], 6u),
                  CCSDS_CFDP_STATUS_OK);
    zassert_equal(ccsds_cfdp_checksum_update(&state, 12u, &data[12], 3u),
                  CCSDS_CFDP_STATUS_OK);
    zassert_equal(ccsds_cfdp_checksum_finish(&state, &checksum),
                  CCSDS_CFDP_STATUS_OK);

    zassert_equal(checksum, checksum_one_shot(data, sizeof(data)));
}

ZTEST(ccsds_cfdp_checksum, test_non_word_aligned_lengths)
{
    static const uint8_t one[] = { 0xaau };
    static const uint8_t three[] = { 0xaau, 0xbbu, 0xccu };
    static const uint8_t five[] = { 0xaau, 0xbbu, 0xccu, 0xddu, 0xeeu };

    zassert_equal(checksum_one_shot(one, sizeof(one)), 0xaa000000u);
    zassert_equal(checksum_one_shot(three, sizeof(three)), 0xaabbcc00u);
    zassert_equal(checksum_one_shot(five, sizeof(five)), 0x98bbccddu);
}

ZTEST(ccsds_cfdp_checksum, test_offset_sensitive_updates_match_annex_f)
{
    static const uint8_t segment0[] = {
        0x00u, 0x01u, 0x02u, 0x03u, 0x04u, 0x05u,
    };
    static const uint8_t segment6[] = {
        0x06u, 0x07u, 0x08u, 0x09u, 0x0au, 0x0bu,
    };
    static const uint8_t segment12[] = {
        0x0cu, 0x0du, 0x0eu,
    };
    ccsds_cfdp_checksum_state_t state;
    uint32_t checksum;

    zassert_equal(ccsds_cfdp_checksum_init(
                      &state, CCSDS_CFDP_CHECKSUM_TYPE_MODULAR),
                  CCSDS_CFDP_STATUS_OK);
    zassert_equal(ccsds_cfdp_checksum_update(&state, 0u, segment0,
                                             sizeof(segment0)),
                  CCSDS_CFDP_STATUS_OK);
    zassert_equal(ccsds_cfdp_checksum_update(&state, 12u, segment12,
                                             sizeof(segment12)),
                  CCSDS_CFDP_STATUS_OK);
    zassert_equal(ccsds_cfdp_checksum_update(&state, 6u, segment6,
                                             sizeof(segment6)),
                  CCSDS_CFDP_STATUS_OK);
    zassert_equal(ccsds_cfdp_checksum_finish(&state, &checksum),
                  CCSDS_CFDP_STATUS_OK);

    zassert_equal(checksum, CCSDS_CFDP_STANDARD_VECTOR_CHECKSUM);
}

ZTEST(ccsds_cfdp_checksum, test_null_checksum_always_zero)
{
    static const uint8_t data[] = { 0xffu, 0xeeu, 0xddu, 0xccu };
    ccsds_cfdp_checksum_state_t state;
    uint32_t checksum = 0xffffffffu;

    zassert_equal(ccsds_cfdp_checksum_init(&state, CCSDS_CFDP_CHECKSUM_TYPE_NULL),
                  CCSDS_CFDP_STATUS_OK);
    zassert_equal(ccsds_cfdp_checksum_update(&state, 0u, data, sizeof(data)),
                  CCSDS_CFDP_STATUS_OK);
    zassert_equal(ccsds_cfdp_checksum_finish(&state, &checksum),
                  CCSDS_CFDP_STATUS_OK);
    zassert_equal(checksum, 0u);
}

ZTEST(ccsds_cfdp_checksum, test_finish_file_modular_does_not_require_reader)
{
    static const uint8_t data[] = {
        0x00u, 0x01u, 0x02u, 0x03u, 0x04u, 0x05u,
    };
    ccsds_cfdp_checksum_state_t state;
    uint32_t checksum;

    zassert_equal(ccsds_cfdp_checksum_init(
                      &state, CCSDS_CFDP_CHECKSUM_TYPE_MODULAR),
                  CCSDS_CFDP_STATUS_OK);
    zassert_equal(ccsds_cfdp_checksum_update(&state, 0u, data, sizeof(data)),
                  CCSDS_CFDP_STATUS_OK);
    zassert_equal(ccsds_cfdp_checksum_finish_file(
                      &state, NULL, NULL, sizeof(data), NULL, 0u, &checksum),
                  CCSDS_CFDP_STATUS_OK);
    zassert_equal(checksum, checksum_one_shot(data, sizeof(data)));
}

ZTEST(ccsds_cfdp_checksum, test_crc32c_uses_standard_vector)
{
    static const uint8_t data[] = "123456789";

    zassert_equal(checksum_one_shot_type(CCSDS_CFDP_CHECKSUM_TYPE_CRC32C,
                                         data, sizeof(data) - 1u),
                  0xe3069283u);
}

ZTEST(ccsds_cfdp_checksum, test_ieee_802_3_fcs_uses_standard_vector)
{
    static const uint8_t data[] = "123456789";

    zassert_equal(checksum_one_shot_type(
                      CCSDS_CFDP_CHECKSUM_TYPE_IEEE_802_3_FCS, data,
                      sizeof(data) - 1u),
                  0xcbf43926u);
}

ZTEST(ccsds_cfdp_checksum, test_crc_incremental_matches_one_shot)
{
    static const uint8_t data[] = {
        0x00u, 0x01u, 0x02u, 0x03u, 0x04u, 0x05u, 0x06u,
        0x07u, 0x08u, 0x09u, 0x0au, 0x0bu, 0x0cu,
    };
    ccsds_cfdp_checksum_state_t state;
    uint32_t checksum;

    zassert_equal(ccsds_cfdp_checksum_init(
                      &state, CCSDS_CFDP_CHECKSUM_TYPE_CRC32C),
                  CCSDS_CFDP_STATUS_OK);
    zassert_equal(ccsds_cfdp_checksum_update(&state, 0u, data, 5u),
                  CCSDS_CFDP_STATUS_OK);
    zassert_equal(ccsds_cfdp_checksum_update(&state, 5u, &data[5],
                                             sizeof(data) - 5u),
                  CCSDS_CFDP_STATUS_OK);
    zassert_equal(ccsds_cfdp_checksum_finish(&state, &checksum),
                  CCSDS_CFDP_STATUS_OK);
    zassert_equal(checksum,
                  checksum_one_shot_type(CCSDS_CFDP_CHECKSUM_TYPE_CRC32C,
                                         data, sizeof(data)));

    zassert_equal(ccsds_cfdp_checksum_init(
                      &state, CCSDS_CFDP_CHECKSUM_TYPE_IEEE_802_3_FCS),
                  CCSDS_CFDP_STATUS_OK);
    zassert_equal(ccsds_cfdp_checksum_update(&state, 0u, data, 5u),
                  CCSDS_CFDP_STATUS_OK);
    zassert_equal(ccsds_cfdp_checksum_update(&state, 5u, &data[5],
                                             sizeof(data) - 5u),
                  CCSDS_CFDP_STATUS_OK);
    zassert_equal(ccsds_cfdp_checksum_finish(&state, &checksum),
                  CCSDS_CFDP_STATUS_OK);
    zassert_equal(checksum,
                  checksum_one_shot_type(
                      CCSDS_CFDP_CHECKSUM_TYPE_IEEE_802_3_FCS, data,
                      sizeof(data)));
}

ZTEST(ccsds_cfdp_checksum, test_crc_updates_defer_noncontiguous_offsets)
{
    static const uint8_t data[] = "123456789";
    struct memory_reader_context reader = {
        .data = data,
        .len = sizeof(data) - 1u,
    };
    ccsds_cfdp_checksum_state_t state;
    uint8_t scratch[4];
    uint32_t checksum;

    zassert_equal(ccsds_cfdp_checksum_init(
                      &state, CCSDS_CFDP_CHECKSUM_TYPE_CRC32C),
                  CCSDS_CFDP_STATUS_OK);
    zassert_equal(ccsds_cfdp_checksum_update(&state, 4u, &data[4], 5u),
                  CCSDS_CFDP_STATUS_OK);
    zassert_equal(ccsds_cfdp_checksum_update(&state, 0u, data, 4u),
                  CCSDS_CFDP_STATUS_OK);
    zassert_equal(ccsds_cfdp_checksum_finish(&state, &checksum),
                  CCSDS_CFDP_STATUS_INVALID_ARGUMENT);
    zassert_equal(ccsds_cfdp_checksum_finish_file(
                      &state, memory_read, &reader, sizeof(data) - 1u,
                      scratch, sizeof(scratch), &checksum),
                  CCSDS_CFDP_STATUS_OK);
    zassert_equal(checksum, 0xe3069283u);

    zassert_equal(ccsds_cfdp_checksum_init(
                      &state, CCSDS_CFDP_CHECKSUM_TYPE_IEEE_802_3_FCS),
                  CCSDS_CFDP_STATUS_OK);
    zassert_equal(ccsds_cfdp_checksum_update(&state, 4u, &data[4], 5u),
                  CCSDS_CFDP_STATUS_OK);
    zassert_equal(ccsds_cfdp_checksum_update(&state, 0u, data, 4u),
                  CCSDS_CFDP_STATUS_OK);
    zassert_equal(ccsds_cfdp_checksum_finish(&state, &checksum),
                  CCSDS_CFDP_STATUS_INVALID_ARGUMENT);
    zassert_equal(ccsds_cfdp_checksum_finish_file(
                      &state, memory_read, &reader, sizeof(data) - 1u,
                      scratch, sizeof(scratch), &checksum),
                  CCSDS_CFDP_STATUS_OK);
    zassert_equal(checksum, 0xcbf43926u);
}

ZTEST(ccsds_cfdp_checksum, test_finish_file_recomputes_incomplete_crc_stream)
{
    static const uint8_t data[] = "123456789";
    struct memory_reader_context reader = {
        .data = data,
        .len = sizeof(data) - 1u,
    };
    ccsds_cfdp_checksum_state_t state;
    uint8_t scratch[3];
    uint32_t checksum;

    zassert_equal(ccsds_cfdp_checksum_init(
                      &state, CCSDS_CFDP_CHECKSUM_TYPE_CRC32C),
                  CCSDS_CFDP_STATUS_OK);
    zassert_equal(ccsds_cfdp_checksum_update(&state, 0u, data, 4u),
                  CCSDS_CFDP_STATUS_OK);
    zassert_equal(ccsds_cfdp_checksum_finish_file(
                      &state, memory_read, &reader, sizeof(data) - 1u,
                      scratch, sizeof(scratch), &checksum),
                  CCSDS_CFDP_STATUS_OK);
    zassert_equal(checksum, 0xe3069283u);
}

ZTEST(ccsds_cfdp_checksum, test_reports_out_of_order_update_capability)
{
    zassert_true(ccsds_cfdp_checksum_supports_out_of_order(
        CCSDS_CFDP_CHECKSUM_TYPE_MODULAR));
    zassert_true(ccsds_cfdp_checksum_supports_out_of_order(
        CCSDS_CFDP_CHECKSUM_TYPE_NULL));
    zassert_false(ccsds_cfdp_checksum_supports_out_of_order(
        CCSDS_CFDP_CHECKSUM_TYPE_CRC32C));
    zassert_false(ccsds_cfdp_checksum_supports_out_of_order(
        CCSDS_CFDP_CHECKSUM_TYPE_IEEE_802_3_FCS));
    zassert_false(ccsds_cfdp_checksum_supports_out_of_order(
        (enum ccsds_cfdp_checksum_type)1));
}

ZTEST(ccsds_cfdp_checksum, test_unsupported_checksum_type_returns_status)
{
    ccsds_cfdp_checksum_state_t state;

    zassert_equal(ccsds_cfdp_checksum_init(
                      &state, (enum ccsds_cfdp_checksum_type)1),
                  CCSDS_CFDP_STATUS_UNSUPPORTED_CHECKSUM);
}

ZTEST(ccsds_cfdp_checksum, test_zero_length_update_accepts_null_buffer)
{
    ccsds_cfdp_checksum_state_t state;
    uint32_t checksum;

    zassert_equal(ccsds_cfdp_checksum_init(
                      &state, CCSDS_CFDP_CHECKSUM_TYPE_MODULAR),
                  CCSDS_CFDP_STATUS_OK);
    zassert_equal(ccsds_cfdp_checksum_update(&state, 123u, NULL, 0u),
                  CCSDS_CFDP_STATUS_OK);
    zassert_equal(ccsds_cfdp_checksum_finish(&state, &checksum),
                  CCSDS_CFDP_STATUS_OK);
    zassert_equal(checksum, 0u);
}

ZTEST_SUITE(ccsds_cfdp_checksum, NULL, NULL, NULL, NULL, NULL);
```

## src/test_ccsds_cfdp_filestore.c
```c
#include <errno.h>
#include <stdbool.h>
#include <stddef.h>
#include <stdint.h>
#include <string.h>

#include <zephyr/ztest.h>

#include "ccsds/ccsds_cfdp_filestore.h"

#define MEM_STORE_MAX_FILES 4u
#define MEM_STORE_MAX_PATH 32u
#define MEM_STORE_MAX_FILE_SIZE 64u

enum mem_file_mode {
    MEM_FILE_MODE_CLOSED = 0,
    MEM_FILE_MODE_READ,
    MEM_FILE_MODE_WRITE_TMP,
};

struct mem_file {
    bool exists;
    bool tmp;
    enum mem_file_mode mode;
    char path[MEM_STORE_MAX_PATH];
    uint8_t data[MEM_STORE_MAX_FILE_SIZE];
    uint32_t size;
};

struct mem_filestore {
    struct mem_file files[MEM_STORE_MAX_FILES];
};

static bool path_matches(const struct mem_file *file, const char *path)
{
    return file->exists && strcmp(file->path, path) == 0;
}

static struct mem_file *find_file(struct mem_filestore *store, const char *path,
                                  bool tmp)
{
    for (size_t i = 0u; i < MEM_STORE_MAX_FILES; i++) {
        if (path_matches(&store->files[i], path) && store->files[i].tmp == tmp) {
            return &store->files[i];
        }
    }

    return NULL;
}

static struct mem_file *alloc_file(struct mem_filestore *store)
{
    for (size_t i = 0u; i < MEM_STORE_MAX_FILES; i++) {
        if (!store->files[i].exists) {
            return &store->files[i];
        }
    }

    return NULL;
}

static int set_path(struct mem_file *file, const char *path)
{
    size_t len;

    if (path == NULL) {
        return -EINVAL;
    }

    len = strlen(path);
    if (len == 0u || len >= MEM_STORE_MAX_PATH) {
        return -EINVAL;
    }

    memcpy(file->path, path, len + 1u);
    return 0;
}

static int seed_file(struct mem_filestore *store, const char *path,
                     const uint8_t *data, uint32_t size)
{
    struct mem_file *file;

    if (store == NULL || data == NULL || size > MEM_STORE_MAX_FILE_SIZE) {
        return -EINVAL;
    }

    file = find_file(store, path, false);
    if (file == NULL) {
        file = alloc_file(store);
    }
    if (file == NULL) {
        return -ENOSPC;
    }

    memset(file, 0, sizeof(*file));
    if (set_path(file, path) != 0) {
        return -EINVAL;
    }

    file->exists = true;
    file->tmp = false;
    file->mode = MEM_FILE_MODE_CLOSED;
    memcpy(file->data, data, size);
    file->size = size;
    return 0;
}

static int mem_open_read(void *user, const char *path, void **handle,
                         uint32_t *size)
{
    struct mem_filestore *store = user;
    struct mem_file *file;

    if (store == NULL || path == NULL || handle == NULL || size == NULL) {
        return -EINVAL;
    }

    file = find_file(store, path, false);
    if (file == NULL) {
        return -ENOENT;
    }

    file->mode = MEM_FILE_MODE_READ;
    *handle = file;
    *size = file->size;
    return 0;
}

static int mem_open_write_tmp(void *user, const char *dst_path, void **handle)
{
    struct mem_filestore *store = user;
    struct mem_file *file;

    if (store == NULL || dst_path == NULL || handle == NULL) {
        return -EINVAL;
    }

    file = find_file(store, dst_path, true);
    if (file == NULL) {
        file = alloc_file(store);
    }
    if (file == NULL) {
        return -ENOSPC;
    }

    memset(file, 0, sizeof(*file));
    if (set_path(file, dst_path) != 0) {
        return -EINVAL;
    }

    file->exists = true;
    file->tmp = true;
    file->mode = MEM_FILE_MODE_WRITE_TMP;
    *handle = file;
    return 0;
}

static int mem_read(void *user, void *handle, uint32_t offset, uint8_t *buf,
                    size_t len, size_t *nread)
{
    struct mem_file *file = handle;
    uint32_t available;

    ARG_UNUSED(user);

    if (handle == NULL || buf == NULL || nread == NULL) {
        return -EINVAL;
    }
    if (!file->exists || file->mode != MEM_FILE_MODE_READ) {
        return -EBADF;
    }

    if (offset >= file->size) {
        *nread = 0u;
        return 0;
    }

    available = file->size - offset;
    if (len > available) {
        len = available;
    }

    memcpy(buf, &file->data[offset], len);
    *nread = len;
    return 0;
}

static int mem_write(void *user, void *handle, uint32_t offset,
                     const uint8_t *buf, size_t len)
{
    struct mem_file *file = handle;
    size_t end;

    ARG_UNUSED(user);

    if (handle == NULL || buf == NULL) {
        return -EINVAL;
    }
    if (!file->exists || !file->tmp || file->mode != MEM_FILE_MODE_WRITE_TMP) {
        return -EBADF;
    }
    if (offset > MEM_STORE_MAX_FILE_SIZE || len > MEM_STORE_MAX_FILE_SIZE) {
        return -EFBIG;
    }

    end = (size_t)offset + len;
    if (end > MEM_STORE_MAX_FILE_SIZE || end < offset) {
        return -EFBIG;
    }

    memcpy(&file->data[offset], buf, len);
    if (end > file->size) {
        file->size = end;
    }

    return 0;
}

static int mem_close(void *user, void *handle)
{
    struct mem_file *file = handle;

    ARG_UNUSED(user);

    if (handle == NULL) {
        return -EINVAL;
    }
    if (!file->exists || file->mode == MEM_FILE_MODE_CLOSED) {
        return -EBADF;
    }

    file->mode = MEM_FILE_MODE_CLOSED;
    return 0;
}

static int mem_commit_tmp(void *user, const char *dst_path)
{
    struct mem_filestore *store = user;
    struct mem_file *tmp;
    struct mem_file *dst;

    if (store == NULL || dst_path == NULL) {
        return -EINVAL;
    }

    tmp = find_file(store, dst_path, true);
    if (tmp == NULL) {
        return -ENOENT;
    }

    dst = find_file(store, dst_path, false);
    if (dst == NULL) {
        dst = alloc_file(store);
    }
    if (dst == NULL) {
        return -ENOSPC;
    }

    memset(dst, 0, sizeof(*dst));
    if (set_path(dst, dst_path) != 0) {
        return -EINVAL;
    }
    dst->exists = true;
    dst->tmp = false;
    dst->mode = MEM_FILE_MODE_CLOSED;
    memcpy(dst->data, tmp->data, tmp->size);
    dst->size = tmp->size;

    memset(tmp, 0, sizeof(*tmp));
    return 0;
}

static int mem_discard_tmp(void *user, const char *dst_path)
{
    struct mem_filestore *store = user;
    struct mem_file *tmp;

    if (store == NULL || dst_path == NULL) {
        return -EINVAL;
    }

    tmp = find_file(store, dst_path, true);
    if (tmp == NULL) {
        return -ENOENT;
    }

    memset(tmp, 0, sizeof(*tmp));
    return 0;
}

static void init_ops(struct mem_filestore *store,
                     ccsds_cfdp_filestore_ops_t *ops)
{
    memset(store, 0, sizeof(*store));
    *ops = (ccsds_cfdp_filestore_ops_t){
        .user = store,
        .open_read = mem_open_read,
        .open_write_tmp = mem_open_write_tmp,
        .read = mem_read,
        .write = mem_write,
        .close = mem_close,
        .commit_tmp = mem_commit_tmp,
        .discard_tmp = mem_discard_tmp,
    };
}

ZTEST(ccsds_cfdp_filestore, test_open_read_returns_handle_and_size)
{
    struct mem_filestore store;
    ccsds_cfdp_filestore_ops_t ops;
    const uint8_t data[] = { 1u, 2u, 3u, 4u };
    void *handle = NULL;
    uint32_t size = 0u;

    init_ops(&store, &ops);
    zassert_equal(seed_file(&store, "source.bin", data, sizeof(data)), 0);

    zassert_equal(ops.open_read(ops.user, "source.bin", &handle, &size), 0);
    zassert_not_null(handle);
    zassert_equal(size, sizeof(data));
}

ZTEST(ccsds_cfdp_filestore, test_read_supports_offsets_and_reports_nread)
{
    struct mem_filestore store;
    ccsds_cfdp_filestore_ops_t ops;
    const uint8_t data[] = { 10u, 11u, 12u, 13u, 14u };
    uint8_t out[4] = { 0u };
    void *handle = NULL;
    uint32_t size = 0u;
    size_t nread = 99u;

    init_ops(&store, &ops);
    zassert_equal(seed_file(&store, "source.bin", data, sizeof(data)), 0);
    zassert_equal(ops.open_read(ops.user, "source.bin", &handle, &size), 0);

    zassert_equal(ops.read(ops.user, handle, 2u, out, sizeof(out), &nread), 0);
    zassert_equal(nread, 3u);
    zassert_mem_equal(out, &data[2], nread);

    zassert_equal(ops.read(ops.user, handle, size, out, sizeof(out), &nread),
                  0);
    zassert_equal(nread, 0u);
}

ZTEST(ccsds_cfdp_filestore, test_open_write_tmp_supports_random_access_writes)
{
    struct mem_filestore store;
    ccsds_cfdp_filestore_ops_t ops;
    const uint8_t tail[] = { 'C', 'D' };
    const uint8_t head[] = { 'A', 'B' };
    uint8_t out[4] = { 0u };
    void *write_handle = NULL;
    void *read_handle = NULL;
    uint32_t size = 0u;
    size_t nread = 0u;

    init_ops(&store, &ops);

    zassert_equal(ops.open_write_tmp(ops.user, "dst.bin", &write_handle), 0);
    zassert_equal(ops.write(ops.user, write_handle, 2u, tail, sizeof(tail)), 0);
    zassert_equal(ops.write(ops.user, write_handle, 0u, head, sizeof(head)), 0);
    zassert_equal(ops.close(ops.user, write_handle), 0);
    zassert_equal(ops.commit_tmp(ops.user, "dst.bin"), 0);

    zassert_equal(ops.open_read(ops.user, "dst.bin", &read_handle, &size), 0);
    zassert_equal(size, sizeof(out));
    zassert_equal(ops.read(ops.user, read_handle, 0u, out, sizeof(out), &nread),
                  0);
    zassert_equal(nread, sizeof(out));
    zassert_mem_equal(out, "ABCD", sizeof(out));
}

ZTEST(ccsds_cfdp_filestore, test_commit_tmp_makes_file_visible)
{
    struct mem_filestore store;
    ccsds_cfdp_filestore_ops_t ops;
    const uint8_t data[] = { 0xA5u, 0x5Au };
    void *handle = NULL;
    uint32_t size = 0u;

    init_ops(&store, &ops);

    zassert_equal(ops.open_write_tmp(ops.user, "new.bin", &handle), 0);
    zassert_equal(ops.write(ops.user, handle, 0u, data, sizeof(data)), 0);
    zassert_equal(ops.commit_tmp(ops.user, "new.bin"), 0);

    handle = NULL;
    zassert_equal(ops.open_read(ops.user, "new.bin", &handle, &size), 0);
    zassert_not_null(handle);
    zassert_equal(size, sizeof(data));
}

ZTEST(ccsds_cfdp_filestore, test_discard_tmp_drops_temp_file)
{
    struct mem_filestore store;
    ccsds_cfdp_filestore_ops_t ops;
    const uint8_t data[] = { 1u };
    void *handle = NULL;
    uint32_t size = 0u;

    init_ops(&store, &ops);

    zassert_equal(ops.open_write_tmp(ops.user, "drop.bin", &handle), 0);
    zassert_equal(ops.write(ops.user, handle, 0u, data, sizeof(data)), 0);
    zassert_equal(ops.discard_tmp(ops.user, "drop.bin"), 0);
    zassert_equal(ops.open_read(ops.user, "drop.bin", &handle, &size),
                  -ENOENT);
}

ZTEST(ccsds_cfdp_filestore, test_close_invalidates_handles)
{
    struct mem_filestore store;
    ccsds_cfdp_filestore_ops_t ops;
    const uint8_t data[] = { 1u, 2u };
    uint8_t out[2] = { 0u };
    void *handle = NULL;
    uint32_t size = 0u;
    size_t nread = 0u;

    init_ops(&store, &ops);
    zassert_equal(seed_file(&store, "source.bin", data, sizeof(data)), 0);
    zassert_equal(ops.open_read(ops.user, "source.bin", &handle, &size), 0);
    zassert_equal(ops.close(ops.user, handle), 0);

    zassert_equal(ops.read(ops.user, handle, 0u, out, sizeof(out), &nread),
                  -EBADF);
    zassert_equal(ops.close(ops.user, handle), -EBADF);
}

ZTEST(ccsds_cfdp_filestore, test_invalid_callback_inputs)
{
    struct mem_filestore store;
    ccsds_cfdp_filestore_ops_t ops;
    const uint8_t data[] = { 1u };
    uint8_t out[1];
    void *handle = NULL;
    uint32_t size = 0u;
    size_t nread = 0u;

    init_ops(&store, &ops);

    zassert_equal(ops.open_read(NULL, "missing.bin", &handle, &size), -EINVAL);
    zassert_equal(ops.open_read(ops.user, NULL, &handle, &size), -EINVAL);
    zassert_equal(ops.open_read(ops.user, "missing.bin", NULL, &size),
                  -EINVAL);
    zassert_equal(ops.open_read(ops.user, "missing.bin", &handle, NULL),
                  -EINVAL);
    zassert_equal(ops.open_read(ops.user, "missing.bin", &handle, &size),
                  -ENOENT);

    zassert_equal(ops.open_write_tmp(NULL, "dst.bin", &handle), -EINVAL);
    zassert_equal(ops.open_write_tmp(ops.user, NULL, &handle), -EINVAL);
    zassert_equal(ops.open_write_tmp(ops.user, "dst.bin", NULL), -EINVAL);

    zassert_equal(ops.read(ops.user, NULL, 0u, out, sizeof(out), &nread),
                  -EINVAL);
    zassert_equal(ops.read(ops.user, handle, 0u, NULL, sizeof(out), &nread),
                  -EINVAL);
    zassert_equal(ops.read(ops.user, handle, 0u, out, sizeof(out), NULL),
                  -EINVAL);

    zassert_equal(ops.write(ops.user, NULL, 0u, data, sizeof(data)), -EINVAL);
    zassert_equal(ops.write(ops.user, handle, 0u, NULL, sizeof(data)),
                  -EINVAL);
    zassert_equal(ops.close(ops.user, NULL), -EINVAL);
    zassert_equal(ops.commit_tmp(NULL, "dst.bin"), -EINVAL);
    zassert_equal(ops.commit_tmp(ops.user, NULL), -EINVAL);
    zassert_equal(ops.discard_tmp(NULL, "dst.bin"), -EINVAL);
    zassert_equal(ops.discard_tmp(ops.user, NULL), -EINVAL);
}

ZTEST_SUITE(ccsds_cfdp_filestore, NULL, NULL, NULL, NULL, NULL);
```

## src/test_ccsds_cfdp_ranges.c
```c
#include <zephyr/ztest.h>

#include "ccsds/ccsds_cfdp_ranges.h"

static void assert_range(const ccsds_cfdp_ranges_t *ranges, size_t index,
                         uint32_t start, uint32_t end)
{
    zassert_true(index < ranges->count);
    zassert_equal(ranges->ranges[index].start, start);
    zassert_equal(ranges->ranges[index].end, end);
}

static bool is_complete(const ccsds_cfdp_ranges_t *ranges, uint32_t start,
                        uint32_t end)
{
    bool complete = false;

    zassert_equal(ccsds_cfdp_ranges_is_complete(ranges, start, end, &complete),
                  CCSDS_CFDP_STATUS_OK);
    return complete;
}

ZTEST(ccsds_cfdp_ranges, test_in_order_ranges)
{
    ccsds_cfdp_ranges_t ranges;

    zassert_equal(ccsds_cfdp_ranges_init(&ranges), CCSDS_CFDP_STATUS_OK);
    zassert_equal(ccsds_cfdp_ranges_add(&ranges, 0u, 4u),
                  CCSDS_CFDP_STATUS_OK);
    zassert_equal(ccsds_cfdp_ranges_add(&ranges, 4u, 8u),
                  CCSDS_CFDP_STATUS_OK);
    zassert_equal(ccsds_cfdp_ranges_add(&ranges, 8u, 12u),
                  CCSDS_CFDP_STATUS_OK);

    zassert_equal(ranges.count, 1u);
    assert_range(&ranges, 0u, 0u, 12u);
    zassert_true(is_complete(&ranges, 0u, 12u));
}

ZTEST(ccsds_cfdp_ranges, test_out_of_order_ranges)
{
    ccsds_cfdp_ranges_t ranges;

    zassert_equal(ccsds_cfdp_ranges_init(&ranges), CCSDS_CFDP_STATUS_OK);
    zassert_equal(ccsds_cfdp_ranges_add(&ranges, 8u, 12u),
                  CCSDS_CFDP_STATUS_OK);
    zassert_equal(ccsds_cfdp_ranges_add(&ranges, 0u, 4u),
                  CCSDS_CFDP_STATUS_OK);
    zassert_equal(ccsds_cfdp_ranges_add(&ranges, 4u, 8u),
                  CCSDS_CFDP_STATUS_OK);

    zassert_equal(ranges.count, 1u);
    assert_range(&ranges, 0u, 0u, 12u);
    zassert_true(is_complete(&ranges, 0u, 12u));
}

ZTEST(ccsds_cfdp_ranges, test_overlapping_ranges)
{
    ccsds_cfdp_ranges_t ranges;

    zassert_equal(ccsds_cfdp_ranges_init(&ranges), CCSDS_CFDP_STATUS_OK);
    zassert_equal(ccsds_cfdp_ranges_add(&ranges, 10u, 20u),
                  CCSDS_CFDP_STATUS_OK);
    zassert_equal(ccsds_cfdp_ranges_add(&ranges, 15u, 25u),
                  CCSDS_CFDP_STATUS_OK);
    zassert_equal(ccsds_cfdp_ranges_add(&ranges, 5u, 12u),
                  CCSDS_CFDP_STATUS_OK);

    zassert_equal(ranges.count, 1u);
    assert_range(&ranges, 0u, 5u, 25u);
    zassert_true(is_complete(&ranges, 10u, 20u));
}

ZTEST(ccsds_cfdp_ranges, test_adjacent_range_merge)
{
    ccsds_cfdp_ranges_t ranges;

    zassert_equal(ccsds_cfdp_ranges_init(&ranges), CCSDS_CFDP_STATUS_OK);
    zassert_equal(ccsds_cfdp_ranges_add(&ranges, 20u, 30u),
                  CCSDS_CFDP_STATUS_OK);
    zassert_equal(ccsds_cfdp_ranges_add(&ranges, 10u, 20u),
                  CCSDS_CFDP_STATUS_OK);
    zassert_equal(ccsds_cfdp_ranges_add(&ranges, 30u, 40u),
                  CCSDS_CFDP_STATUS_OK);

    zassert_equal(ranges.count, 1u);
    assert_range(&ranges, 0u, 10u, 40u);
}

ZTEST(ccsds_cfdp_ranges, test_missing_ranges_after_eof_style_file_size)
{
    ccsds_cfdp_ranges_t ranges;
    ccsds_cfdp_ranges_t missing;
    const uint32_t file_size = 32u;

    zassert_equal(ccsds_cfdp_ranges_init(&ranges), CCSDS_CFDP_STATUS_OK);
    zassert_equal(ccsds_cfdp_ranges_add(&ranges, 0u, 8u),
                  CCSDS_CFDP_STATUS_OK);
    zassert_equal(ccsds_cfdp_ranges_add(&ranges, 12u, 20u),
                  CCSDS_CFDP_STATUS_OK);
    zassert_equal(ccsds_cfdp_ranges_add(&ranges, 24u, file_size),
                  CCSDS_CFDP_STATUS_OK);

    zassert_false(is_complete(&ranges, 0u, file_size));
    zassert_equal(ccsds_cfdp_ranges_missing(&ranges, 0u, file_size, &missing),
                  CCSDS_CFDP_STATUS_OK);
    zassert_equal(missing.count, 2u);
    assert_range(&missing, 0u, 8u, 12u);
    assert_range(&missing, 1u, 20u, 24u);
}

ZTEST(ccsds_cfdp_ranges, test_overflow_behavior)
{
    ccsds_cfdp_ranges_t ranges;

    zassert_equal(ccsds_cfdp_ranges_init(&ranges), CCSDS_CFDP_STATUS_OK);

    for (uint32_t i = 0u; i < CCSDS_CFDP_MAX_NAK_RANGES; i++) {
        uint32_t start = i * 10u;

        zassert_equal(ccsds_cfdp_ranges_add(&ranges, start, start + 1u),
                      CCSDS_CFDP_STATUS_OK);
    }

    zassert_equal(ranges.count, CCSDS_CFDP_MAX_NAK_RANGES);
    zassert_equal(ccsds_cfdp_ranges_add(&ranges, 1000u, 1001u),
                  CCSDS_CFDP_STATUS_BUFFER_TOO_SMALL);
    zassert_equal(ranges.count, CCSDS_CFDP_MAX_NAK_RANGES);
}

ZTEST(ccsds_cfdp_ranges, test_invalid_ranges)
{
    ccsds_cfdp_ranges_t ranges;
    ccsds_cfdp_ranges_t missing;
    bool complete = true;

    zassert_equal(ccsds_cfdp_ranges_init(&ranges), CCSDS_CFDP_STATUS_OK);
    zassert_equal(ccsds_cfdp_ranges_add(&ranges, 4u, 4u),
                  CCSDS_CFDP_STATUS_INVALID_ARGUMENT);
    zassert_equal(ccsds_cfdp_ranges_add(&ranges, 5u, 4u),
                  CCSDS_CFDP_STATUS_INVALID_ARGUMENT);
    zassert_equal(ccsds_cfdp_ranges_is_complete(&ranges, 9u, 9u, &complete),
                  CCSDS_CFDP_STATUS_INVALID_ARGUMENT);
    zassert_equal(ccsds_cfdp_ranges_missing(&ranges, 10u, 2u, &missing),
                  CCSDS_CFDP_STATUS_INVALID_ARGUMENT);
}

ZTEST_SUITE(ccsds_cfdp_ranges, NULL, NULL, NULL, NULL, NULL);
```

## src/test_ccsds_cfdp_service.c
```c
#include <string.h>

#include <zephyr/ztest.h>

#include "ccsds_cfdp_service.h"

struct service_fixture {
    struct ccsds_cfdp_service service;
    struct ccsds_router router;
    ccsds_cfdp_filestore_ops_t filestore;
    uint32_t sent;
};

static int send_packet(void *user, const uint8_t *packet, size_t packet_len)
{
    struct service_fixture *fixture = user;

    zassert_not_null(packet);
    zassert_true(packet_len >= CCSDS_SPACE_PACKET_PRIMARY_HDR_LEN);
    fixture->sent++;
    return 0;
}

static int open_read(void *user, const char *path, void **handle,
                     uint32_t *size)
{
    static uint8_t data[] = {1u, 2u, 3u};

    ARG_UNUSED(user);
    ARG_UNUSED(path);
    *handle = data;
    *size = sizeof(data);
    return 0;
}

static int read_file(void *user, void *handle, uint32_t offset, uint8_t *buf,
                     size_t len, size_t *nread)
{
    static const uint8_t data[] = {1u, 2u, 3u};

    ARG_UNUSED(user);
    ARG_UNUSED(handle);
    *nread = MIN(len, sizeof(data) - offset);
    memcpy(buf, &data[offset], *nread);
    return 0;
}

static int close_file(void *user, void *handle)
{
    ARG_UNUSED(user);
    ARG_UNUSED(handle);
    return 0;
}

static void init_fixture(struct service_fixture *fixture, uint64_t local,
                         uint64_t remote, uint16_t apid)
{
    struct ccsds_cfdp_service_config config;

    memset(fixture, 0, sizeof(*fixture));
    fixture->filestore = (ccsds_cfdp_filestore_ops_t){
        .open_read = open_read,
        .read = read_file,
        .close = close_file,
    };
    config = (struct ccsds_cfdp_service_config){
        .local_entity_id = local,
        .remote_entity_id = remote,
        .entity_id_len = 1u,
        .transaction_sequence_number_len = 1u,
        .initial_transaction_sequence_number = 1u,
        .local_apid = apid,
        .remote_apid = apid,
        .packet_type = CCSDS_PACKET_TYPE_TC,
        .send_packet = send_packet,
        .send_user = fixture,
        .receive_filestore = &fixture->filestore,
    };
    ccsds_router_init(&fixture->router);
    zassert_equal(ccsds_cfdp_service_init(&fixture->service, &config),
                  CCSDS_CFDP_STATUS_OK);
    zassert_ok(
        ccsds_cfdp_service_register_rx(&fixture->service, &fixture->router));
}

ZTEST(ccsds_cfdp_service, test_two_services_own_independent_state)
{
    struct service_fixture a;
    struct service_fixture b;
    const ccsds_cfdp_put_request_t request = {
        .source_path = "source.bin",
        .destination_path = "destination.bin",
        .checksum_type = CCSDS_CFDP_CHECKSUM_TYPE_MODULAR,
    };
    ccsds_cfdp_transaction_id_t a_id;
    ccsds_cfdp_transaction_id_t b_id;

    init_fixture(&a, 1u, 2u, 0x340u);
    init_fixture(&b, 9u, 10u, 0x341u);

    zassert_equal(ccsds_cfdp_service_send_file(
                      &a.service, &a.filestore, &request, &a_id),
                  CCSDS_CFDP_STATUS_OK);
    zassert_equal(ccsds_cfdp_service_send_file(
                      &b.service, &b.filestore, &request, &b_id),
                  CCSDS_CFDP_STATUS_OK);
    zassert_equal(a_id.source_entity_id, 1u);
    zassert_equal(b_id.source_entity_id, 9u);
    zassert_equal(a.sent, 3u);
    zassert_equal(b.sent, 3u);
    zassert_not_equal(&a.service.entity, &b.service.entity);
    zassert_not_equal(&a.service.adapter, &b.service.adapter);
}

ZTEST_SUITE(ccsds_cfdp_service, NULL, NULL, NULL, NULL, NULL);
```

## src/test_ccsds_cfdp_types.c
```c
#include <zephyr/ztest.h>

#include "ccsds/ccsds_cfdp_types.h"

ZTEST(ccsds_cfdp_types, test_config_backed_limits)
{
    zassert_equal(CCSDS_CFDP_VERSION_1, 1u);
    zassert_equal(CCSDS_CFDP_MAX_ENTITY_ID_LEN,
                  CONFIG_CCSDS_CFDP_MAX_ENTITY_ID_LEN);
    zassert_equal(CCSDS_CFDP_MAX_TRANS_SEQ_LEN,
                  CONFIG_CCSDS_CFDP_MAX_TRANS_SEQ_LEN);
    zassert_equal(CCSDS_CFDP_MAX_FILENAME_LEN,
                  CONFIG_CCSDS_CFDP_MAX_FILENAME_LEN);
    zassert_equal(CCSDS_CFDP_MAX_PDU_SIZE,
                  CONFIG_CCSDS_CFDP_MAX_PDU_SIZE);
    zassert_equal(CCSDS_CFDP_MAX_SEGMENT_SIZE,
                  CONFIG_CCSDS_CFDP_MAX_SEGMENT_SIZE);
    zassert_equal(CCSDS_CFDP_MAX_NAK_RANGES,
                  CONFIG_CCSDS_CFDP_MAX_NAK_RANGES);
    zassert_equal(CCSDS_CFDP_MAX_NAK_ROUNDS,
                  CONFIG_CCSDS_CFDP_MAX_NAK_ROUNDS);
    zassert_equal(CCSDS_CFDP_MAX_ACTIVE_TX, 1u);
    zassert_equal(CCSDS_CFDP_MAX_ACTIVE_RX, 1u);
}

ZTEST(ccsds_cfdp_types, test_fixed_header_enums_match_standard_values)
{
    zassert_equal(CCSDS_CFDP_PDU_TYPE_FILE_DIRECTIVE, 0);
    zassert_equal(CCSDS_CFDP_PDU_TYPE_FILE_DATA, 1);
    zassert_equal(CCSDS_CFDP_DIRECTION_TOWARD_RECEIVER, 0);
    zassert_equal(CCSDS_CFDP_DIRECTION_TOWARD_SENDER, 1);
    zassert_equal(CCSDS_CFDP_TRANSMISSION_MODE_ACKNOWLEDGED, 0);
    zassert_equal(CCSDS_CFDP_TRANSMISSION_MODE_UNACKNOWLEDGED, 1);
    zassert_equal(CCSDS_CFDP_CRC_NOT_PRESENT, 0);
    zassert_equal(CCSDS_CFDP_CRC_PRESENT, 1);
    zassert_equal(CCSDS_CFDP_FILE_SIZE_SMALL, 0);
    zassert_equal(CCSDS_CFDP_FILE_SIZE_LARGE, 1);
}

ZTEST(ccsds_cfdp_types, test_directive_and_condition_codes)
{
    zassert_equal(CCSDS_CFDP_DIRECTIVE_EOF, 0x04);
    zassert_equal(CCSDS_CFDP_DIRECTIVE_FINISHED, 0x05);
    zassert_equal(CCSDS_CFDP_DIRECTIVE_ACK, 0x06);
    zassert_equal(CCSDS_CFDP_DIRECTIVE_METADATA, 0x07);
    zassert_equal(CCSDS_CFDP_DIRECTIVE_NAK, 0x08);

    zassert_equal(CCSDS_CFDP_CONDITION_NO_ERROR, 0x0);
    zassert_equal(CCSDS_CFDP_CONDITION_INVALID_TRANSMISSION_MODE, 0x3);
    zassert_equal(CCSDS_CFDP_CONDITION_FILESTORE_REJECTION, 0x4);
    zassert_equal(CCSDS_CFDP_CONDITION_FILE_CHECKSUM_FAILURE, 0x5);
    zassert_equal(CCSDS_CFDP_CONDITION_FILE_SIZE_ERROR, 0x6);
    zassert_equal(CCSDS_CFDP_CONDITION_NAK_LIMIT_REACHED, 0x7);
    zassert_equal(CCSDS_CFDP_CONDITION_INACTIVITY_DETECTED, 0x8);
    zassert_equal(CCSDS_CFDP_CONDITION_UNSUPPORTED_CHECKSUM_TYPE, 0xB);
    zassert_equal(CCSDS_CFDP_CONDITION_CANCEL_REQUEST_RECEIVED, 0xF);
}

ZTEST(ccsds_cfdp_types, test_finished_and_checksum_enums)
{
    zassert_equal(CCSDS_CFDP_DELIVERY_CODE_DATA_COMPLETE, 0);
    zassert_equal(CCSDS_CFDP_DELIVERY_CODE_DATA_INCOMPLETE, 1);
    zassert_equal(CCSDS_CFDP_FILE_STATUS_DISCARDED_DELIBERATELY, 0);
    zassert_equal(CCSDS_CFDP_FILE_STATUS_DISCARDED_FILESTORE_REJECTION, 1);
    zassert_equal(CCSDS_CFDP_FILE_STATUS_RETAINED, 2);
    zassert_equal(CCSDS_CFDP_FILE_STATUS_UNREPORTED, 3);
    zassert_equal(CCSDS_CFDP_CHECKSUM_TYPE_MODULAR, 0);
    zassert_equal(CCSDS_CFDP_CHECKSUM_TYPE_CRC32C, 2);
    zassert_equal(CCSDS_CFDP_CHECKSUM_TYPE_IEEE_802_3_FCS, 3);
    zassert_equal(CCSDS_CFDP_CHECKSUM_TYPE_NULL, 15);
}

ZTEST(ccsds_cfdp_types, test_status_codes_are_distinct)
{
    zassert_equal(CCSDS_CFDP_STATUS_OK, 0);
    zassert_not_equal(CCSDS_CFDP_STATUS_MALFORMED_PDU,
                      CCSDS_CFDP_STATUS_UNSUPPORTED);
    zassert_not_equal(CCSDS_CFDP_STATUS_UNSUPPORTED_CHECKSUM,
                      CCSDS_CFDP_STATUS_CHECKSUM_FAILURE);
}

ZTEST_SUITE(ccsds_cfdp_types, NULL, NULL, NULL, NULL, NULL);
```

## src/test_ccsds_cfdp_ut.c
```c
#include <errno.h>
#include <stdbool.h>
#include <stddef.h>
#include <stdint.h>
#include <string.h>

#include <zephyr/ztest.h>

#include "ccsds/ccsds_cfdp_entity.h"

#define LOOPBACK_MAX_PDU_SIZE 32u

struct loopback_ut {
    uint64_t local_entity_id;
    uint64_t now_ms;
    ccsds_cfdp_receive_pdu_cb_t receive;
    void *receive_user;
    bool drop_first_octet_enabled;
    uint8_t drop_first_octet;
    uint32_t sent_count;
    uint32_t delivered_count;
    uint32_t dropped_count;
    uint64_t last_dest_entity_id;
};

struct receive_capture {
    bool called;
    void *expected_user;
    uint64_t source_entity_id;
    uint8_t pdu[LOOPBACK_MAX_PDU_SIZE];
    size_t pdu_len;
};

static int loopback_send_pdu(void *user, uint64_t dest_entity_id,
                             const uint8_t *pdu, size_t pdu_len)
{
    struct loopback_ut *ut = user;

    if (ut == NULL || pdu == NULL || pdu_len == 0u ||
        pdu_len > LOOPBACK_MAX_PDU_SIZE) {
        return -EINVAL;
    }
    if (ut->receive == NULL) {
        return -ENOTCONN;
    }

    ut->sent_count++;
    ut->last_dest_entity_id = dest_entity_id;

    if (ut->drop_first_octet_enabled && pdu[0] == ut->drop_first_octet) {
        ut->dropped_count++;
        return 0;
    }

    ut->delivered_count++;
    ut->receive(ut->receive_user, ut->local_entity_id, pdu, pdu_len);
    return 0;
}

static uint64_t loopback_now_ms(void *user)
{
    const struct loopback_ut *ut = user;

    if (ut == NULL) {
        return 0u;
    }

    return ut->now_ms;
}

static void capture_receive(void *user, uint64_t source_entity_id,
                            const uint8_t *pdu, size_t pdu_len)
{
    struct receive_capture *capture = user;

    zassert_not_null(capture);
    zassert_equal(user, capture->expected_user);
    zassert_not_null(pdu);
    zassert_true(pdu_len <= sizeof(capture->pdu));

    capture->called = true;
    capture->source_entity_id = source_entity_id;
    memcpy(capture->pdu, pdu, pdu_len);
    capture->pdu_len = pdu_len;
}

static void init_loopback(struct loopback_ut *ut,
                          ccsds_cfdp_ut_ops_t *ops,
                          struct receive_capture *capture)
{
    memset(ut, 0, sizeof(*ut));
    memset(capture, 0, sizeof(*capture));

    ut->local_entity_id = 42u;
    ut->now_ms = 123456u;
    ut->receive = capture_receive;
    ut->receive_user = capture;
    capture->expected_user = capture;

    *ops = (ccsds_cfdp_ut_ops_t){
        .user = ut,
        .send_pdu = loopback_send_pdu,
        .now_ms = loopback_now_ms,
    };
}

ZTEST(ccsds_cfdp_ut, test_send_invokes_registered_receiver)
{
    struct loopback_ut ut;
    ccsds_cfdp_ut_ops_t ops;
    struct receive_capture capture;
    const uint8_t pdu[] = { 0x07u, 0xAAu, 0x55u };

    init_loopback(&ut, &ops, &capture);

    zassert_equal(ops.send_pdu(ops.user, 99u, pdu, sizeof(pdu)), 0);

    zassert_true(capture.called);
    zassert_equal(capture.source_entity_id, ut.local_entity_id);
    zassert_equal(capture.pdu_len, sizeof(pdu));
    zassert_mem_equal(capture.pdu, pdu, sizeof(pdu));
    zassert_equal(ut.sent_count, 1u);
    zassert_equal(ut.delivered_count, 1u);
    zassert_equal(ut.dropped_count, 0u);
    zassert_equal(ut.last_dest_entity_id, 99u);
}

ZTEST(ccsds_cfdp_ut, test_user_pointers_are_propagated)
{
    struct loopback_ut ut;
    ccsds_cfdp_ut_ops_t ops;
    struct receive_capture capture;
    const uint8_t pdu[] = { 0x04u };

    init_loopback(&ut, &ops, &capture);

    zassert_equal(ops.user, &ut);
    zassert_equal(ut.receive_user, &capture);
    zassert_equal(ops.send_pdu(ops.user, 77u, pdu, sizeof(pdu)), 0);
    zassert_true(capture.called);
    zassert_equal(capture.expected_user, &capture);
}

ZTEST(ccsds_cfdp_ut, test_now_callback_uses_transport_user_pointer)
{
    struct loopback_ut ut;
    ccsds_cfdp_ut_ops_t ops;
    struct receive_capture capture;

    init_loopback(&ut, &ops, &capture);

    zassert_equal(ops.now_ms(ops.user), ut.now_ms);
}

ZTEST(ccsds_cfdp_ut, test_loopback_can_drop_selected_first_octet)
{
    struct loopback_ut ut;
    ccsds_cfdp_ut_ops_t ops;
    struct receive_capture capture;
    const uint8_t dropped_pdu[] = { 0xFDu, 0x01u };

    init_loopback(&ut, &ops, &capture);
    ut.drop_first_octet_enabled = true;
    ut.drop_first_octet = dropped_pdu[0];

    zassert_equal(ops.send_pdu(ops.user, 99u, dropped_pdu,
                               sizeof(dropped_pdu)), 0);

    zassert_false(capture.called);
    zassert_equal(ut.sent_count, 1u);
    zassert_equal(ut.delivered_count, 0u);
    zassert_equal(ut.dropped_count, 1u);
}

ZTEST(ccsds_cfdp_ut, test_invalid_loopback_inputs)
{
    struct loopback_ut ut;
    ccsds_cfdp_ut_ops_t ops;
    struct receive_capture capture;
    uint8_t pdu[LOOPBACK_MAX_PDU_SIZE + 1u] = { 0u };

    init_loopback(&ut, &ops, &capture);

    zassert_equal(ops.send_pdu(NULL, 99u, pdu, 1u), -EINVAL);
    zassert_equal(ops.send_pdu(ops.user, 99u, NULL, 1u), -EINVAL);
    zassert_equal(ops.send_pdu(ops.user, 99u, pdu, 0u), -EINVAL);
    zassert_equal(ops.send_pdu(ops.user, 99u, pdu, sizeof(pdu)), -EINVAL);

    ut.receive = NULL;
    zassert_equal(ops.send_pdu(ops.user, 99u, pdu, 1u), -ENOTCONN);
    zassert_equal(ops.now_ms(NULL), 0u);
}

ZTEST_SUITE(ccsds_cfdp_ut, NULL, NULL, NULL, NULL, NULL);
```
