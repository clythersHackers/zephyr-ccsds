## tests/cfdp/testcase.yaml
```yaml
# SPDX-License-Identifier: Apache-2.0

tests:
  ccsds.cfdp:
    tags:
      - ccsds
      - cfdp
      - module
    platform_allow:
      - native_sim
    harness: ztest
    timeout: 120
    min_ram: 512
```

## tests/frames/testcase.yaml
```yaml
# SPDX-License-Identifier: Apache-2.0

tests:
  ccsds.frames:
    tags:
      - ccsds
      - module
    platform_allow:
      - native_sim
    harness: ztest
  ccsds.frames.sdls:
    tags:
      - ccsds
      - module
      - sdls
    platform_allow:
      - native_sim
    harness: ztest
    extra_configs:
      - CONFIG_CCSDS_SDLS=y
      - CONFIG_ZTEST_STACK_SIZE=8192
      - CONFIG_HEAP_MEM_POOL_SIZE=4096
```

## tests/module_boundary/testcase.yaml
```yaml
# SPDX-License-Identifier: Apache-2.0

tests:
  ccsds.module_boundary:
    tags:
      - ccsds
      - module
    platform_allow:
      - native_sim
    harness: ztest
```

## tests/primitives/testcase.yaml
```yaml
# SPDX-License-Identifier: Apache-2.0

tests:
  ccsds.primitives:
    tags:
      - ccsds
      - module
    platform_allow:
      - native_sim
    harness: ztest
```

## tests/sdls/testcase.yaml
```yaml
# SPDX-License-Identifier: Apache-2.0

tests:
  ccsds.sdls.endpoint:
    tags:
      - ccsds
      - sdls
      - psa
    platform_allow:
      - native_sim
    harness: ztest
```

## zephyr/Kconfig
```kconfig
# SPDX-License-Identifier: Apache-2.0

menuconfig CCSDS
	bool "CCSDS protocol support"
	default n
	help
	  Enable reusable Consultative Committee for Space Data Systems
	  protocol support provided by the CCSDS Zephyr module.

if CCSDS

config CCSDS_ROUTER_MAX_APIDS
	int "Maximum registered CCSDS APID handlers"
	default 8
	range 1 64

config CCSDS_FRAME_SUPPORT
	bool "Enable CCSDS frame and channel-coding support"
	default y

config CCSDS_MAX_CLTU_LEN
	int "Maximum CCSDS CLTU length"
	default 1024
	range 64 65535
	depends on CCSDS_FRAME_SUPPORT

config CCSDS_MAX_FRAME_LEN
	int "Maximum CCSDS transfer frame length"
	default 1115
	range 32 65535
	depends on CCSDS_FRAME_SUPPORT

config CCSDS_TC_MAX_SPACE_PACKET_LEN
	int "Maximum CCSDS TC Space Packet length"
	default 2048
	range 7 65535
	depends on CCSDS_FRAME_SUPPORT

config CCSDS_COP1_WINDOW_SIZE
	int "CCSDS COP-1 acceptance window size"
	default 128
	range 4 128
	depends on CCSDS_FRAME_SUPPORT

config CCSDS_SPACECRAFT_ID
	int "CCSDS spacecraft ID"
	default 123
	range 0 1023
	depends on CCSDS_FRAME_SUPPORT

config CCSDS_TM_MAX_SPACE_PACKET_LEN
	int "Maximum CCSDS TM Space Packet length"
	default 2048
	range 7 65535
	depends on CCSDS_FRAME_SUPPORT

config CCSDS_TM_QUEUE_DEPTH
	int "CCSDS TM queue depth per VC"
	default CCSDS_TM_MAX_SPACE_PACKET_LEN
	range 7 65535
	depends on CCSDS_FRAME_SUPPORT

config CCSDS_RS
	bool "Enable CCSDS Reed-Solomon primitive"
	default y
	depends on CCSDS_FRAME_SUPPORT

config CCSDS_RS_INTERLEAVE_DEPTH
	int "CCSDS Reed-Solomon interleave depth"
	default 5
	range 1 8
	depends on CCSDS_RS

config CCSDS_RND
	bool "Enable CCSDS randomization primitive"
	default n
	depends on CCSDS_FRAME_SUPPORT

config CCSDS_TM_RND
	bool "Apply CCSDS randomization to TM channel frames"
	default n
	depends on CCSDS_FRAME_SUPPORT
	select CCSDS_RND

config CCSDS_TC_RND
	bool "Apply CCSDS derandomization to TC transfer frames"
	default n
	depends on CCSDS_FRAME_SUPPORT
	select CCSDS_RND

config CCSDS_TM_FECF
	bool "Enable CCSDS TM Frame Error Control Field"
	default n if CCSDS_RS
	default y
	depends on CCSDS_FRAME_SUPPORT

config CCSDS_UDP
	bool
	default y

if CCSDS_UDP

config CCSDS_UDP_MAX_UNIT_LEN
	int "Maximum CCSDS UDP bounded-unit length"
	default CCSDS_MAX_CLTU_LEN if CCSDS_FRAME_SUPPORT
	default 1024
	range 7 65535
	help
	  Maximum datagram held by each caller-owned CCSDS UDP adapter instance.

config CCSDS_UDP_THREAD_STACK_SIZE
	int "CCSDS UDP adapter thread stack size"
	default 2048
	range 1024 8192
	help
	  Stack reserved inside each caller-owned CCSDS UDP adapter instance.

endif # CCSDS_UDP

config CCSDS_CFDP
	bool "Enable CCSDS CFDP support"
	default n
	select CRC
	help
	  Enable the reusable CCSDS File Delivery Protocol core, including PDU
	  codecs, checksums, missing-range tracking, entity state, and the Space
	  Packet adapter.

if CCSDS_CFDP

config CCSDS_CFDP_MAX_ENTITY_ID_LEN
	int "Maximum CFDP entity ID length"
	default 4
	range 1 8

config CCSDS_CFDP_MAX_TRANS_SEQ_LEN
	int "Maximum CFDP transaction sequence number length"
	default 4
	range 1 8

config CCSDS_CFDP_MAX_FILENAME_LEN
	int "Maximum CFDP file name length"
	default 64
	range 0 255

config CCSDS_CFDP_MAX_PDU_SIZE
	int "Maximum CFDP PDU size"
	default 512
	range 64 65535

config CCSDS_CFDP_MAX_SEGMENT_SIZE
	int "Maximum CFDP file data segment size"
	default 384
	range 1 65535

config CCSDS_CFDP_MAX_NAK_RANGES
	int "Maximum CFDP NAK ranges"
	default 4
	range 1 64

config CCSDS_CFDP_MAX_NAK_ROUNDS
	int "Maximum CFDP NAK rounds"
	default 4
	range 1 255

endif # CCSDS_CFDP

config CCSDS_SDLS
	bool "Enable CCSDS Space Data Link Security"
	default n
	select MBEDTLS
	select MBEDTLS_PSA_CRYPTO_C
	select PSA_WANT_ALG_GCM
	select PSA_WANT_KEY_TYPE_AES
	help
	  Enable fixed-capacity SDLS state and transport-independent wire
	  processing through PSA AES-256-GCM and GMAC. Algorithms and field
	  lengths are fixed by the compiled profile.

if CCSDS_SDLS

config CCSDS_SDLS_MAX_SA
	int "Maximum configured SDLS security associations"
	default 4
	range 1 255
	help
	  Number of Security Association state slots embedded in every SDLS
	  context. Slots are populated only when the context is initialized.

config CCSDS_SDLS_MAX_KEYS
	int "Maximum configured SDLS keys"
	default 8
	range 2 255
	help
	  Number of opaque PSA key-reference slots embedded in every SDLS
	  context. Operational key bytes are never stored in this table.

config CCSDS_SDLS_SESSION_KEY_BASE
	int "First SDLS session-key identifier"
	default 4
	range 1 254
	help
      Key identifiers below this value address pre-provisioned slots. Key
	  identifiers from this value through CCSDS_SDLS_MAX_KEYS - 1 address
	  session-key slots. This value must be less than CCSDS_SDLS_MAX_KEYS.

config CCSDS_SDLS_ARSN_WINDOW
	int "Maximum accepted SDLS ARSN advance"
	default 1024
	range 1 2147483647
	help
	  A received ARSN must be greater than the last authenticated value and
	  may advance by at most this amount. This permits lost frames without
	  retaining an out-of-order replay bitmap.

config CCSDS_SDLS_EVENT_LOG_CAPACITY
	int "SDLS security-event log capacity"
	default 8
	range 1 255
	help
	  Number of compact security-event records embedded in every SDLS
	  context. A full log continuously cycles, replacing its oldest record.

config CCSDS_SDLS_IV_SEED_HIGH
	hex "Upper 32 bits of the fixed SDLS IV seed"
	default 0x00000000
	range 0x0 0xffffffff

config CCSDS_SDLS_IV_SEED_LOW
	hex "Lower 32 bits of the fixed SDLS IV seed"
	default 0x00000000
	range 0x0 0xffffffff

endif # CCSDS_SDLS

endif # CCSDS
```
