## CMakeLists.txt
```
# SPDX-License-Identifier: Apache-2.0

cmake_minimum_required(VERSION 3.20.0)

# Load only the CCSDS module so this test remains consumer-independent.
set(ZEPHYR_MODULES "${CMAKE_CURRENT_LIST_DIR}/../..")

find_package(Zephyr REQUIRED HINTS $ENV{ZEPHYR_BASE})
project(ccsds_primitives)

target_sources(app PRIVATE
  src/test_ccsds_bch.c
  src/test_ccsds_crc16.c
  src/test_ccsds_rnd.c
  src/test_ccsds_rs.c
  src/test_ccsds_space_packet.c
)
```

## prj.conf
```kconfig
# SPDX-License-Identifier: Apache-2.0

CONFIG_ZTEST=y
CONFIG_CCSDS=y
CONFIG_CCSDS_RND=y
```

## src/test_ccsds_bch.c
```c
#include <string.h>
#include <zephyr/ztest.h>

#include "ccsds/ccsds_bch.h"

ZTEST(ccsds_bch, test_zero_data_vector)
{
    /* All-zero data has zero BCH remainder; CCSDS transmits parity inverted. */
    uint8_t block[CCSDS_BCH_BLOCK_SIZE] = {
        0x00, 0x00, 0x00, 0x00, 0x00, 0x00, 0x00, 0xfe
    };
    uint8_t data[CCSDS_BCH_DATA_SIZE];
    int corrected_bit = 123;

    zassert_equal(ccsds_bch_decode_block(block, data, &corrected_bit),
                  CCSDS_BCH_OK);
    zassert_equal(corrected_bit, -1);
    zassert_mem_equal(data, block, sizeof(data));
}

ZTEST(ccsds_bch, test_nonzero_data_vector)
{
    /* 0x0123456789abcd encoded with g(x)=x^7+x^6+x^2+1, parity inverted. */
    uint8_t block[CCSDS_BCH_BLOCK_SIZE] = {
        0x01, 0x23, 0x45, 0x67, 0x89, 0xab, 0xcd, 0x90
    };
    uint8_t data[CCSDS_BCH_DATA_SIZE];
    int corrected_bit = 123;

    zassert_equal(ccsds_bch_decode_block(block, data, &corrected_bit),
                  CCSDS_BCH_OK);
    zassert_equal(corrected_bit, -1);
    zassert_mem_equal(data, block, sizeof(data));
}

ZTEST(ccsds_bch, test_corrects_each_single_bit_error)
{
    static const uint8_t expected[CCSDS_BCH_BLOCK_SIZE] = {
        0x01, 0x23, 0x45, 0x67, 0x89, 0xab, 0xcd, 0x90
    };
    static const uint8_t expected_data[CCSDS_BCH_DATA_SIZE] = {
        0x01, 0x23, 0x45, 0x67, 0x89, 0xab, 0xcd
    };

    for (int bit = 0; bit < 63; bit++) {
        uint8_t block[CCSDS_BCH_BLOCK_SIZE];
        uint8_t data[CCSDS_BCH_DATA_SIZE];
        int corrected_bit = -1;

        memcpy(block, expected, sizeof(block));
        block[bit / 8] ^= (uint8_t)(0x80u >> (bit % 8));

        zassert_equal(ccsds_bch_decode_block(block, data, &corrected_bit),
                      CCSDS_BCH_CORRECTED, "bit %d", bit);
        zassert_equal(corrected_bit, bit, "bit %d", bit);
        zassert_mem_equal(data, expected_data, sizeof(data), "bit %d", bit);
    }
}

ZTEST(ccsds_bch, test_detects_double_bit_error)
{
    uint8_t block[CCSDS_BCH_BLOCK_SIZE] = {
        0x01, 0x23, 0x45, 0x67, 0x89, 0xab, 0xcd, 0x90
    };
    uint8_t data[CCSDS_BCH_DATA_SIZE];
    int corrected_bit = 123;

    block[0] ^= 0x80u;
    block[7] ^= 0x02u;

    zassert_equal(ccsds_bch_decode_block(block, data, &corrected_bit),
                  CCSDS_BCH_DETECTED_EVEN);
    zassert_equal(corrected_bit, -1);
}

ZTEST_SUITE(ccsds_bch, NULL, NULL, NULL, NULL, NULL);
```

## src/test_ccsds_crc16.c
```c
#include <zephyr/ztest.h>

#include "ccsds/ccsds_crc16.h"

ZTEST(ccsds_crc16, test_standard_check_vector)
{
    static const uint8_t data[] = "123456789";

    zassert_equal(ccsds_crc16_compute(data, sizeof(data) - 1u),
                  CCSDS_CRC16_CHECK_VECTOR);
}

ZTEST(ccsds_crc16, test_incremental_matches_one_shot)
{
    static const uint8_t data[] = {
        0x08, 0x2a, 0xc0, 0x01, 0x00, 0x03, 0xde, 0xad, 0xbe, 0xef
    };
    uint16_t crc = CCSDS_CRC16_INIT;

    crc = ccsds_crc16_update(crc, data, 3u);
    crc = ccsds_crc16_update(crc, data + 3u, sizeof(data) - 3u);

    zassert_equal(crc, ccsds_crc16_compute(data, sizeof(data)));
}

ZTEST(ccsds_crc16, test_check_accepts_valid_codeword)
{
    uint8_t codeword[] = {
        0x08, 0x2a, 0xc0, 0x01, 0x00, 0x03, 0xde, 0xad, 0xbe, 0xef,
        0x00, 0x00
    };
    uint16_t crc = ccsds_crc16_compute(codeword,
                                       sizeof(codeword) - CCSDS_CRC16_LEN);

    codeword[sizeof(codeword) - 2u] = (uint8_t)(crc >> 8);
    codeword[sizeof(codeword) - 1u] = (uint8_t)crc;

    zassert_true(ccsds_crc16_check(codeword, sizeof(codeword)));
    zassert_equal(ccsds_crc16_compute(codeword, sizeof(codeword)), 0u);
}

ZTEST(ccsds_crc16, test_check_rejects_invalid_codeword)
{
    uint8_t codeword[] = {
        0x08, 0x2a, 0xc0, 0x01, 0x00, 0x03, 0xde, 0xad, 0xbe, 0xef,
        0x00, 0x00
    };
    uint16_t crc = ccsds_crc16_compute(codeword,
                                       sizeof(codeword) - CCSDS_CRC16_LEN);

    codeword[sizeof(codeword) - 2u] = (uint8_t)(crc >> 8);
    codeword[sizeof(codeword) - 1u] = (uint8_t)crc;
    codeword[4] ^= 0x01u;

    zassert_false(ccsds_crc16_check(codeword, sizeof(codeword)));
}

ZTEST(ccsds_crc16, test_check_rejects_missing_crc)
{
    static const uint8_t data[] = { 0x00 };

    zassert_false(ccsds_crc16_check(data, sizeof(data)));
}

ZTEST_SUITE(ccsds_crc16, NULL, NULL, NULL, NULL, NULL);
```

## src/test_ccsds_rnd.c
```c
#include <string.h>

#include <zephyr/ztest.h>

#include "ccsds/ccsds_rnd.h"

ZTEST(ccsds_rnd, test_known_sequence_prefix)
{
    static const uint8_t expected[] = {
        0xff, 0x48, 0x0e, 0xc0, 0x9a, 0x0d, 0x70, 0xbc,
        0x8e, 0x2c, 0x93, 0xad, 0xa7, 0xb7, 0x46, 0xce,
        0x5a, 0x97, 0x7d, 0xcc, 0x32, 0xa2, 0xbf, 0x3e,
        0x0a, 0x10, 0xf1, 0x88, 0x94, 0xcd, 0xea, 0xb1,
        0xfe, 0x90, 0x1d, 0x81, 0x34, 0x1a, 0xe1, 0x79,
    };
    uint8_t data[sizeof(expected)] = { 0 };

    ccsds_rnd_apply(data, sizeof(data));
    zassert_mem_equal(data, expected, sizeof(expected));
}

ZTEST(ccsds_rnd, test_apply_is_self_inverse)
{
    uint8_t data[] = {
        0x08, 0x2a, 0xc0, 0x01, 0x00, 0x03, 0xde, 0xad,
        0xbe, 0xef, 0x55, 0xaa, 0x12, 0x34, 0x56, 0x78,
    };
    uint8_t original[sizeof(data)];

    memcpy(original, data, sizeof(data));

    ccsds_rnd_apply(data, sizeof(data));
    zassert_not_equal(memcmp(data, original, sizeof(data)), 0);
    ccsds_rnd_apply(data, sizeof(data));
    zassert_mem_equal(data, original, sizeof(data));
}

ZTEST(ccsds_rnd, test_wraps_after_255_bytes)
{
    uint8_t data[256] = { 0 };

    ccsds_rnd_apply(data, sizeof(data));
    zassert_equal(data[0], data[255]);
}

ZTEST(ccsds_rnd, test_accepts_null_empty_buffer)
{
    ccsds_rnd_apply(NULL, 0u);
}

ZTEST_SUITE(ccsds_rnd, NULL, NULL, NULL, NULL, NULL);
```

## src/test_ccsds_rs.c
```c
#include <string.h>
#include <zephyr/ztest.h>

#include "ccsds/ccsds_rs.h"

static const uint8_t rs_generator[CCSDS_RS_PARITY_LEN] = {
    0x01, 0x18, 0x14, 0x1d, 0x24, 0x11, 0x1a, 0x0c,
    0x1e, 0x22, 0x07, 0x0c, 0x25, 0xfe, 0x61, 0x26,
    0xef, 0x2c, 0x3d, 0x2a, 0x2c, 0xec, 0xda, 0xeb,
    0xc1, 0x6e, 0xda, 0x20, 0x28, 0x2c, 0xc1, 0xa8
};

static uint8_t rs_ref_gf_mul(uint8_t a, uint8_t b)
{
    uint8_t product = 0u;

    while (a != 0u && b != 0u) {
        if ((b & 1u) != 0u) {
            product ^= a;
        }

        a = (a & 0x80u) != 0u ? (uint8_t)((a << 1) ^ 0x87u) :
                                 (uint8_t)(a << 1);
        b >>= 1;
    }

    return product;
}

static void rs_ref_encode_codeblock(const uint8_t *data, uint8_t *parity)
{
    memset(parity, 0, CCSDS_RS_PARITY_LEN);

    for (size_t i = 0u; i < CCSDS_RS_DATA_LEN; i++) {
        uint8_t feedback = data[i] ^ parity[CCSDS_RS_PARITY_LEN - 1u];

        for (size_t j = CCSDS_RS_PARITY_LEN - 1u; j > 0u; j--) {
            parity[j] = parity[j - 1u] ^
                        rs_ref_gf_mul(feedback, rs_generator[j]);
        }

        parity[0] = feedback;
    }
}

static void assert_encoded_matches_reference(
    const uint8_t data[CCSDS_RS_INTERLEAVED_DATA_LEN])
{
    uint8_t expected_parity[CCSDS_RS_INTERLEAVED_PARITY_LEN];
    uint8_t parity[CCSDS_RS_INTERLEAVED_PARITY_LEN];

    for (size_t i = 0u; i < CCSDS_RS_INTERLEAVE_DEPTH; i++) {
        rs_ref_encode_codeblock(data + (i * CCSDS_RS_DATA_LEN),
                                expected_parity +
                                    (i * CCSDS_RS_PARITY_LEN));
    }

    memset(parity, 0xa5, sizeof(parity));

    ccsds_rs_encode(data, parity);

    zassert_mem_equal(parity, expected_parity, CCSDS_RS_INTERLEAVED_PARITY_LEN);
}

ZTEST(ccsds_rs, test_zero_data_vector)
{
    uint8_t data[CCSDS_RS_INTERLEAVED_DATA_LEN] = {0};

    assert_encoded_matches_reference(data);
}

ZTEST(ccsds_rs, test_pattern_data_vector)
{
    uint8_t data[CCSDS_RS_INTERLEAVED_DATA_LEN];

    for (size_t i = 0u; i < sizeof(data); i++) {
        data[i] = (uint8_t)((i * 37u) ^ (i >> 1) ^ 0x5au);
    }

    assert_encoded_matches_reference(data);
}

ZTEST_SUITE(ccsds_rs, NULL, NULL, NULL, NULL, NULL);
```

## src/test_ccsds_space_packet.c
```c
#include <errno.h>
#include <string.h>

#include <zephyr/ztest.h>

#include <ccsds/ccsds_space_packet.h>

ZTEST(ccsds_space_packet, test_known_packet_round_trip)
{
    static const uint8_t payload[] = { 0xde, 0xad, 0xbe };
    static const uint8_t expected[] = {
        0x18, 0x01, 0xc0, 0x2a, 0x00, 0x02, 0xde, 0xad, 0xbe,
    };
    const struct ccsds_space_packet input = {
        .version = 0u,
        .type = CCSDS_PACKET_TYPE_TC,
        .secondary_header = true,
        .apid = 1u,
        .sequence_flags = CCSDS_SEQUENCE_UNSEGMENTED,
        .sequence_count = 42u,
        .payload = payload,
        .payload_len = sizeof(payload),
    };
    struct ccsds_space_packet output;
    uint8_t encoded[sizeof(expected)];
    size_t encoded_len;

    zassert_ok(ccsds_space_packet_encode(&input, encoded, sizeof(encoded),
                                         &encoded_len));
    zassert_equal(encoded_len, sizeof(expected));
    zassert_mem_equal(encoded, expected, sizeof(expected));

    zassert_ok(ccsds_space_packet_decode(encoded, encoded_len, &output));
    zassert_equal(output.version, input.version);
    zassert_equal(output.type, input.type);
    zassert_equal(output.secondary_header, input.secondary_header);
    zassert_equal(output.apid, input.apid);
    zassert_equal(output.sequence_flags, input.sequence_flags);
    zassert_equal(output.sequence_count, input.sequence_count);
    zassert_equal(output.payload_len, input.payload_len);
    zassert_mem_equal(output.payload, input.payload, input.payload_len);
}

ZTEST(ccsds_space_packet, test_reports_short_buffers)
{
    static const uint8_t payload[] = { 0x5a };
    const struct ccsds_space_packet packet = {
        .version = 0u,
        .type = CCSDS_PACKET_TYPE_TM,
        .secondary_header = false,
        .apid = 2u,
        .sequence_flags = CCSDS_SEQUENCE_UNSEGMENTED,
        .sequence_count = 0u,
        .payload = payload,
        .payload_len = sizeof(payload),
    };
    uint8_t encoded[CCSDS_SPACE_PACKET_PRIMARY_HDR_LEN + sizeof(payload)];
    size_t encoded_len;

    zassert_equal(ccsds_space_packet_encode(&packet, encoded,
                                            sizeof(encoded) - 1u,
                                            &encoded_len),
                  -ENOSPC);
    zassert_equal(ccsds_space_packet_decode(
                      encoded, CCSDS_SPACE_PACKET_PRIMARY_HDR_LEN - 1u,
                      &(struct ccsds_space_packet){0}),
                  -EINVAL);
}

ZTEST(ccsds_space_packet, test_encoded_length_includes_primary_header)
{
    zassert_equal(ccsds_space_packet_encoded_len(17u),
                  CCSDS_SPACE_PACKET_PRIMARY_HDR_LEN + 17u);
}

ZTEST_SUITE(ccsds_space_packet, NULL, NULL, NULL, NULL, NULL);
```
